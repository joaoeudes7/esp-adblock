// ESP ADBlock — DNS sinkhole + web dashboard.
// Blocklist = a Bloom filter bitmap in flash ('BLM1' header + bits), probed with k=7
// FNV-1a hashes. No blocklist RAM; events are ring-buffered and the browser keeps the history.
// Targets: ESP8266 (port) and ESP32/C3/S3 — selected with #if defined(ESP8266).
//
// The remote blocklist update runs in the BROWSER: it downloads the file over TLS and POSTs it
// to /upload. This firmware therefore has no TLS/HTTPClient dependency at all.
//
// ESP8266 notes: single-core, no PSRAM (~20-40 KB heap), so the bitmap lives in flash.
//  - Preferences.h doesn't exist -> tiny EEPROM-backed shim below.
//  - Updater/WebServer/mDNS headers differ from the ESP32 core.

#if defined(ESP8266)
#include <ESP8266WiFi.h>
#include <WiFiUdp.h>
#include <LittleFS.h>
#include <ESP8266mDNS.h>
#include <ESP8266WebServer.h>
#include <Updater.h> // firmware OTA (Update object)
#include <ArduinoOTA.h>
#include <EEPROM.h>
#include "lwip/etharp.h"
#include "lwip/netif.h"

#define WEBSERVER_TYPE ESP8266WebServer
static inline uint32_t rnd32() { return RANDOM_REG32; }
static inline float temperatureRead() { return 0.0f; } // no temp sensor on ESP8266

// Minimal Preferences-compatible shim: 2x96-byte strings in EEPROM (ssid/pass).
class Preferences {
public:
  void begin(const char* ns, bool ro = false) {
    (void)ns;
    _ro = ro;
    if (!_begun) {
      EEPROM.begin(512);
      _begun = true;
    }
  }
  void end() {}
  String getString(const char* key, const char* dflt) {
    char b[96];
    EEPROM.get(_off(key), b);
    b[95] = 0;
    if (b[0] == 0 || (uint8_t)b[0] == 0xFF) return String(dflt);
    return String(b);
  }
  void putString(const char* key, const String& v) {
    char b[96];
    memset(b, 0, sizeof(b));
    v.toCharArray(b, sizeof(b));
    EEPROM.put(_off(key), b);
    EEPROM.commit();
  }
  void clear() {
    for (int i = 0; i < 512; i++) EEPROM.write(i, 0);
    EEPROM.commit();
  }

private:
  bool _ro = false, _begun = false;
  int _off(const char* k) { return strcmp(k, "ssid") == 0 ? 0 : 96; }
};
#else
#include <Arduino.h>
#include <WiFi.h>
#include <WiFiUdp.h>
#include <LittleFS.h>
#include <ESPmDNS.h>
#include <WebServer.h>
#include <Update.h>      // firmware OTA
#include <ArduinoOTA.h>  // network firmware flashing (pio run over wifi)
#include <Preferences.h> // NVS store for provisioned WiFi creds
#include <esp_system.h>  // esp_reset_reason() for the persisted boot record
#if !defined(ESP8266)
#include <esp_ota_ops.h> // rollback confirm (ESP32 bootloader has it enabled)
#endif

#define WEBSERVER_TYPE WebServer
static inline uint32_t rnd32() { return esp_random(); }
#endif

// ESP32 core 3.x deprecated NetworkUDP::flush() in favour of clear(); older cores still use flush().
static inline void udpDrop(WiFiUDP& u) {
#if defined(ESP8266) || !defined(ESP_ARDUINO_VERSION_MAJOR) || ESP_ARDUINO_VERSION_MAJOR < 3
  u.flush();
#else
  u.clear();
#endif
}

#if !defined(ESP8266)
#include "lwip/etharp.h"
#include "lwip/netif.h"
#else
ADC_MODE(ADC_VCC); // route the ADC to read the chip supply (brownout diagnosis)
#endif

#include "concurrency.h" // cooperative helpers: TcpRelay (TCP :53) + DeferredFlag
#include "geo_table.h"   // /14 IPv4 -> country byte (tools/build_geo_table.py)
#include "boot_debug.h"  // optional boot/crash record (-D BOOT_DEBUG=1); no-op stubs otherwise

// Firmware version — shown on the dashboard + /stats.json.
// Override at build time with: build_flags = -D FW_VERSION='"1.2.3"'
#ifndef FW_VERSION
#define FW_VERSION "1.3.0"
#endif

static inline uint32_t chipVcc() { // supply voltage in mV (0 = unsupported)
#if defined(ESP8266)
  return ESP.getVcc();
#else
  return 0;
#endif
}

// Status LED: brief blink on every blocked lookup (non-blocking). Default = the board's
// built-in LED (ESP-12/NodeMCU: GPIO2, active-low). Define LED_PIN to use an external one.
#ifndef LED_PIN
#ifdef LED_BUILTIN
#define LED_PIN LED_BUILTIN
#else
#define LED_PIN 2
#endif
#endif
#ifndef LED_ACTIVE_LOW // override with -DLED_ACTIVE_LOW=0 for an active-high LED
#if defined(ESP8266)
#define LED_ACTIVE_LOW 1 // ESP-12/NodeMCU onboard LED is active-low
#else
#define LED_ACTIVE_LOW 0
#endif
#endif
#if LED_ACTIVE_LOW
#define LED_ON LOW
#define LED_OFF HIGH
#else
#define LED_ON HIGH
#define LED_OFF LOW
#endif
static const uint32_t LED_BLINK_MS = 40;
static uint32_t ledUntil = 0; // millis() until which the LED stays lit (0 = off)

#include "secrets.h" // WIFI_* / WEB_USER / WEB_PASS — generated by tools/gen_config.py
                     // from config.env (baked at build time).
#include "cpu_governor.h"

// ---- config ----
#ifndef UPSTREAM_DNS_LIST
#define UPSTREAM_DNS_LIST "1.1.1.1" // comma-separated candidates; fastest probe wins
#endif
#ifndef UPSTREAM_PORT
#define UPSTREAM_PORT 53
#endif
#include "dns_pick.h"
#include "resp_cache.h"
#include "host_regex.h"
static const int MAX_DNS = 4;                        // upstream candidates (see /dns.cfg)
static const uint32_t DNS_PROBE_INTERVAL_MS = 60000; // full latency sweep once a minute
static const uint16_t DNS_PROBE_TIMEOUT_MS = 400;    // a resolver slower than this loses the round
static const char* DNS_PROBE_NAME = "example.com";
static IPAddress dnsList[MAX_DNS];                 // candidate resolvers
static uint16_t dnsRtt[MAX_DNS];                   // last probe RTT (0 = unknown, DNS_DEAD = failed)
static uint8_t dnsFails[MAX_DNS];                  // consecutive failed probes
static int dnsCount = 0, dnsCur = 0, dnsNext = -1; // dnsNext = pending switch (applied when idle)
static IPAddress upstreamIP(1, 1, 1, 1);           // active forwarder == dnsList[dnsCur]
static const uint16_t DNS_PORT = 53;
static const uint16_t BLACKHOLE_PORT = 81; // PAC-routed URL matches are dropped here
static const uint32_t TTL_CLAMP_S = 300;   // rewrite answer TTL down to this (0 = off); fast policy changes
static const char* BLOCKLIST_PATH = "/blocklist.bin";
#if defined(ESP8266)
static const int CACHE_SIZE = 64; // must be power of 2
static const int MAX_CLIENTS = 24;
static const int MAX_CUSTOM = 48;
static const int MAX_ALLOW = 64;
static const int RESP_CACHE_N = 32; // total entries, 2-way (must be power of 2)
static const int RESP_MAX = 128;    // max cached reply size (A/AAAA + most CNAME chains; larger is forwarded uncached)
static const int MAX_RGX = 16;      // hostname regex patterns loaded from the bin (BLM2)
static const int RGX_MAXLEN = 96;   // max pattern length kept (longer records skipped)
static const int MAX_URL = 24;      // PAC URL-block patterns (/rules.cfg "url <substr>")
#else
static const int CACHE_SIZE = 256; // must be power of 2
static const int MAX_CLIENTS = 96;
static const int MAX_CUSTOM = 200;
static const int MAX_ALLOW = 128;
static const int RESP_CACHE_N = 64; // total entries, 2-way (must be power of 2)
static const int RESP_MAX = 512;
static const int MAX_RGX = 64;      // hostname regex patterns loaded from the bin (BLM2)
static const int RGX_MAXLEN = 128;  // max pattern length kept (longer records skipped)
static const int MAX_URL = 64;      // PAC URL-block patterns (/rules.cfg "url <substr>")
#endif
static const int INFLIGHT_N = 8;    // concurrent upstream queries
static const int EV_N = 16;         // recent-blocked ring (the browser keeps the history)
static const int MAX_HOSTS = 16;    // local DNS records
static const int MAX_TEMPALLOW = 8; // temporary block-page allows (host + expiry)
static const int MAX_KW = 64;       // user keyword rules (/rules.cfg); >= 46 defaults
static const int MAX_WILD = 16;     // user wildcard rules (/rules.cfg "wildcard *.x.y")
static const uint8_t BLOCK_MODE_IP = 0, BLOCK_MODE_ZERO = 1, BLOCK_MODE_NX = 2;

// ---- globals ----
WiFiUDP dnsServer, upstreamCli, probeCli;
WiFiServer tcpDns(DNS_PORT); // TCP :53 fallback (truncated/large upstream replies)
WiFiServer blackhole(BLACKHOLE_PORT); // PAC URL matches are accepted then dropped
WEBSERVER_TYPE web(80);
File blocklist;
uint32_t numHashes = 0, totalBlocked = 0, totalAllowed = 0, totalCached = 0;
uint32_t rttMs = 0; // average of the last RTT_WINDOW upstream resolution times (ms)
static const int RTT_WINDOW = 16;
static uint16_t rttRing[RTT_WINDOW];
static uint8_t rttIdx = 0, rttCnt = 0;
static uint32_t rttSum = 0;
uint32_t locMs = 0; // average ESP-side (non-forward) time per forwarded query: parse + scheduling + reply (ms)
static uint16_t locRing[RTT_WINDOW];
static uint8_t locIdx = 0, locCnt = 0;
static uint32_t locSum = 0;
uint32_t dnsTimeouts = 0; // upstream queries that never got a reply (expired in-flight)
uint32_t lastDnsMs = 0;   // millis() of the last handled DNS query (gate the blocking remote fetch)
uint32_t dohHits = 0;     // client queries for known encrypted-DNS (DoH/DoT) endpoints (bypass attempts)
uint32_t pacHits = 0;     // requests received on the black-hole port (a client is using the PAC)
// hot-path counters (diagnostics): flash probes and cache behaviour per query
uint32_t stQueries = 0, stBlkChecks = 0, stBlkHits = 0, stBloomSeeks = 0, stRespCached = 0;
uint32_t stMaxGap = 0, stMaxWeb = 0, stMaxDns = 0, stMaxTcp = 0; // worst-case (µs): loop gap / web / dns / tcp fallback
// Pre-OOM breadcrumb: the lowest free heap seen since boot + what was running at that moment.
// Without it a burst that nearly OOM'd leaves no trace at all (String just truncates).
uint32_t stMinHeap = 0xFFFFFFFF, stMinHeapAt = 0; // value + uptime (ms) of the low point
uint8_t stMinHeapCtx = 0;                          // 1 = web handler, 2 = DNS path

static uint32_t bootId = 0; // increments every boot so open dashboards reload

static inline void noteHeap(uint8_t ctx) {
  uint32_t h = ESP.getFreeHeap();
  if (h < stMinHeap) {
    stMinHeap = h;
    stMinHeapAt = millis();
    stMinHeapCtx = ctx;
    bootDbgNoteHeap(h, ctx); // no-op unless BOOT_DEBUG: keeps the crash record's watermark current
  }
}
uint8_t buf[1536];                                 // fits any non-fragmented UDP reply (EDNS answers can exceed 512)
// TCP :53 has its own buffer: `buf` is reused by handleDns() every loop, so a job cannot
// keep a pointer into it across yields. Single-owner: only loop() drives it.
static uint8_t tcpBuf[1536];
static cc::TcpRelay tcpRelay;
static cc::DeferredFlag statsSaveReq; // dirty flag consumed by loop() when idle

// Bloom filter: the bitmap lives in flash (after an 8-byte header), so RAM use is
// O(1) in the number of blocked domains — that is the whole point vs the old
// sorted-hash blob (which needed 20 KB of index on the ESP32 and log2(n) reads).
static uint32_t bloomM = 0;              // bitmap bit count
static uint32_t bloomBase = 8;           // bitmap offset in the file: 8 (BLM1) or 12 (BLM2)
static const uint8_t BLOOM_K = 7;        // hash functions (match tools/build_bin_list_block.py)
static const uint32_t BLOCKLIST_HDR = 8; // 'BLM1' + uint32 domain count (BLM2 adds a uint32 size)
// Hostname regexes carried by a BLM2 blob (the compiler can't turn a regex into bloom
// bits). Loaded into RAM — bounded by MAX_RGX × RGX_MAXLEN. Matched only on a bloom miss.
static char rgxPat[MAX_RGX][RGX_MAXLEN];
static uint16_t numRgx = 0;
// GAFM section: builder-compiled provider Blooms (G/A/F/Amazon/Microsoft) loaded to RAM, used
// only for read-only telemetry — share of ALLOWED DNS lookups per provider. Not blocking.
static uint8_t gafamBuf[384];
static uint16_t gafamOff[5], gafamLen[5];
static bool gafamOk = false;
static uint32_t gafamCnt[6] = {0}; // G, A, F(Meta), Amazon, Microsoft, other
// Estimated destination country per allowed resolution (dashboard map). RAM only:
// fills as traffic flows, empties on reboot (the card says "since reboot").
static uint32_t geoHits[GEO_NCODES]; // 32-bit: one busy country can pass 65k before reboot
static uint32_t geoMapped = 0;
static uint32_t dnssecOk = 0, dnssecSeen = 0; // forwarded replies: AD bit set / total
// small direct-mapped cache (both targets)
static uint32_t cacheKey32[CACHE_SIZE];
static uint8_t cacheRes[CACHE_SIZE];
static uint8_t cacheValid[CACHE_SIZE];

// DNS response cache (TTL-clamped, 2-way) — cuts repeated upstream lookups and keeps the
// frequently-hit domains cached across set collisions (see src/resp_cache.h for the logic).
static RespCache<RESP_CACHE_N, RESP_MAX> respCache;
// Async forwarder: in-flight queries awaiting an upstream reply.
struct InFlight {
  uint16_t wid;
  uint16_t cid;
  uint32_t cip;
  uint16_t cport;
  uint16_t qend;
  uint32_t key;
  uint32_t sentAt;
  uint32_t t0;
  bool used;
};
static InFlight inflight[INFLIGHT_N];

// Recent-blocked events: a tiny ring in RAM. No history is stored on the device — the
// dashboard polls /events?since=<seq> and keeps the list client-side.
struct BlockEv {
  uint32_t seq;
  uint32_t ts;
  uint32_t cip;
  char host[48];
  uint16_t count; // burst strategy: repeats of the same host fold into one entry
};
static BlockEv evRing[EV_N];
static uint32_t evSeq = 0;

// Privacy/security response-header level (0=off .. 3=strict). Baked default = config.env
// PRIVACY_LEVEL (secrets.h SEC_LEVEL); overridable at runtime and persisted in /block.cfg.
#ifndef SEC_LEVEL
#define SEC_LEVEL 2
#endif
#define SEC_HDR_TOTAL 10 // max privacy headers (level 3 + CSP) — gauge denominator
static uint8_t secLevel = SEC_LEVEL;
static uint32_t secPages = 0;    // HTML pages served WITH the privacy rewrite (numerator)
static uint32_t pagesServed = 0; // all HTML pages served (denominator) -> % protected pages
static uint8_t secHdrCount(uint8_t lv) { return lv >= 3 ? 10 : lv >= 2 ? 8
                                                           : lv >= 1   ? 3
                                                                       : 0; }
// Blocked-reply mode (configurable): 0 = ESP IP (block page), 1 = 0.0.0.0, 2 = NXDOMAIN.
static uint8_t blockMode = BLOCK_MODE_IP;
// TTL (seconds) of a blocked answer -> how long clients cache "this host is blocked"
// before asking again. 0 = no caching (a pause/resume takes effect on the next query).
static uint32_t blockTtl = 30;
// IPv4-only: strip AAAA (return NODATA) so clients that use this resolver stay on IPv4.
static bool ipv4Only = true;
// Keyword heuristic (opt-in): block hosts whose labels match common ad/tracker tokens.
static bool keywordBlock = true;
// DNS-rebinding guard (opt-in): drop upstream answers pointing at private IPs.
static bool rebindGuard = false;
// SafeSearch (opt-in), per search engine: a bitmask of providers to force.
// AAAA must be NODATA (handled by ipv4Only) or an IPv6 client would bypass it.
enum { SS_GOOGLE = 1,
       SS_YOUTUBE = 2,
       SS_BING = 4,
       SS_DDG = 8 };
static uint8_t safeSearchMask = 0;

struct Dev {
  uint32_t ip;
  uint8_t mac[6];
  uint32_t blocked, allowed, lastSeen;
  uint32_t pac; // requests seen on the black-hole port => this client is using the PAC
  uint16_t qps;
  uint32_t win;
  uint32_t pausedUntil;
};
Dev clients[MAX_CLIENTS];
int numClients = 0;
// Friendly names per client (matched by IP), persisted in /names.cfg.
static const int MAX_NAMES = 24;
struct ClientName {
  uint32_t ip;
  String name;
};
static ClientName clientNames[MAX_NAMES];
static int numNames = 0;

// User rules, unified in /rules.cfg (one per line):
//   block   <domain>    block the domain and all its subdomains
//   allow   <domain>    exception (wins over block)
//   keyword <token>     block any host whose labels match the token
String blockDom[MAX_CUSTOM];
int numBlock = 0;
String allowDom[MAX_ALLOW];
int numAllow = 0;
// Temporary allows (block page "continue for N minutes"): in RAM only, self-expiring.
struct TempAllow {
  char host[48];
  uint32_t until;
};
static TempAllow tempAllow[MAX_TEMPALLOW];
String kwDom[MAX_KW];
int numKw = 0;
String wildDom[MAX_WILD];
int numWild = 0; // wildcard block patterns ("*.ads.example.com")
// PAC URL-block patterns ("url /js/ads.js"): matched against the full URL by the CLIENT's
// PAC, which routes matches to this device's black-hole port (drop -> resource fails).
String urlDom[MAX_URL];
int numUrl = 0;

// The blocklist update is done by the browser now (download + POST /upload).
uint32_t lastWeb = 0; // last time web.handleClient() ran
uint32_t wifiDownSince = 0, lastReconn = 0;
uint8_t reconnAttempts = 0; // WiFi watchdog state
uint32_t lastUpdateMs = 0;  // millis() of the last successful blocklist upload (0 = this boot)

// WiFi provisioning
Preferences prefs;
String cfgIp, cfgGw, cfgDns, cfgHost; // from /wifi.cfg (empty -> secrets.h)

// blocking pause (Pi-hole-style "disable for a while")
bool blockingOn = true;
uint32_t resumeAt = 0; // millis() to auto-resume; 0 = paused indefinitely / not paused

// ---------- hashing / matching ----------
// ---------- Bloom membership ----------
// Bits live in flash after BLOCKLIST_HDR; memory is O(1) in the domain count.
// k probes via Kirsch-Mitzenmacher: idx_i = (a + i*b) mod m, a/b = the two 32-bit
// halves of a full FNV-1a — same construction as tools/build_bin_list_block.py.
static uint64_t fnv64(const char* s, size_t n) {
  uint64_t h = 0xcbf29ce484222325ULL;
  for (size_t i = 0; i < n; i++) {
    h ^= (uint8_t)s[i];
    h *= 0x100000001b3ULL;
  }
  return h;
}
static void buildFlashIndex() {
  for (int i = 0; i < CACHE_SIZE; i++) cacheValid[i] = 0;
}
static inline uint8_t bloomBit(uint32_t bit) {
  stBloomSeeks++;
  if (!blocklist.seek(bloomBase + (bit >> 3))) return 0;
  uint8_t b = 0;
  blocklist.read(&b, 1);
  return (b >> (bit & 7)) & 1;
}
static bool inFlash(uint64_t h) {
  if (bloomM == 0) return false;
  uint32_t a = (uint32_t)(h >> 32), b = (uint32_t)h;
  for (uint8_t i = 0; i < BLOOM_K; i++) {
    uint32_t bit = (uint32_t)(a + (uint32_t)i * b) % bloomM;
    if (!bloomBit(bit)) return false; // short-circuit on the first zero bit
  }
  return true;
}

static bool isAllowDomain(const char* d); // defined with the other persistence helpers
static bool isTempAllowed(const char* d); // time-limited allow (block page "continue for 5 min")

// User blocklist (from /rules.cfg "block <domain>"): matched against each label suffix
// by the caller, so a rule for example.com also blocks ads.example.com.
static bool isBlockDomain(const char* d) {
  for (int i = 0; i < numBlock; i++)
    if (strcmp(blockDom[i].c_str(), d) == 0) return true;
  return false;
}
// Wildcard rules ("*.ads.example.com"): iterative glob matcher, '*' = any run of chars
// (dots included), no allocation. Patterns keep an explicit '.' so "*.ads.com" can't match
// "notads.com". Kept separate from the exact lists so the hot path stays a strcmp.
static bool globMatch(const char* pat, const char* d) {
  const char *star = nullptr, *ss = nullptr;
  while (*d) {
    if (*pat == '*') {
      star = pat++;
      ss = d;
    } else if (*pat == *d) {
      pat++;
      d++;
    } else if (star) {
      pat = star + 1;
      d = ++ss;
    } else return false;
  }
  while (*pat == '*') pat++;
  return *pat == 0;
}
static bool isWildBlock(const char* d) {
  for (int i = 0; i < numWild; i++)
    if (globMatch(wildDom[i].c_str(), d)) return true;
  return false;
}
static bool isBlockedHash(uint64_t h) {
  stBlkChecks++;
  uint32_t slot = (uint32_t)h & (CACHE_SIZE - 1);
  if (cacheValid[slot] && cacheKey32[slot] == (uint32_t)h) {
    stBlkHits++;
    return cacheRes[slot] != 0;
  }
  bool res = inFlash(h);
  cacheValid[slot] = 1;
  cacheKey32[slot] = (uint32_t)h;
  cacheRes[slot] = res ? 1 : 0;
  return res;
}

// Keyword heuristic: match whole labels (split on '.' and '-') against the user's
// keyword rules (/rules.cfg "keyword <t>"), plus the "ads" prefix. Whole-label only,
// so "downloads" is safe. KW_DEFAULT seeds /rules.cfg on first boot.
static const char* const KW_DEFAULT[] = {
    "ads", "ad", "adserver", "adservice", "adserv", "adtech", "adnxs", "adcolony", "adform",
    "adition", "adroll", "adsrv", "adsrvr", "doubleclick", "pagead", "syndication",
    "analytics", "tracker", "trackers", "tracking", "track", "telemetry", "beacon", "pixel",
    "moatads", "outbrain", "taboola", "criteo", "scorecardresearch", "quantserve",
    "applovin", "appsflyer", "adjust", "kochava", "amplitude", "mixpanel", "hotjar",
    "fullstory", "mouseflow", "luckyorange", "newrelic", "optimizely", "demdex",
    "everesttech", "teads", "adobedtm"};
static bool keywordHit(const char* d) {
  char buf[256];
  size_t n = strlen(d);
  if (n >= sizeof(buf)) n = sizeof(buf) - 1;
  memcpy(buf, d, n);
  buf[n] = 0;
  for (char* p = buf; *p;) {
    char* start = p;
    while (*p && *p != '.' && *p != '-') p++;
    char save = *p;
    *p = 0;
    if (strncmp(start, "ads", 3) == 0) return true;
    for (int i = 0; i < numKw; i++)
      if (strcmp(start, kwDom[i].c_str()) == 0) return true;
    if (save == 0) break;
    p++;
  }
  return false;
}
// Built-in connectivity-check allowlist: OEM/captive-portal probe domains that MUST resolve
// or phones show a false "sign in to network" portal. Checked before the blocklist (some
// OEM-telemetry lists block them — that is a classic false positive).
static const char* const ALLOW_DEFAULT[] = {
    "allawnos.com", // OPPO / Realme / OnePlus (BBK) connectivity check (conn-service-*.allawnos.com)
    "connectivitycheck.gstatic.com", "connectivitycheck.android.com",
    "clients3.google.com", "clients4.google.com",  // Android / Google
    "captive.apple.com",                           // Apple
    "www.msftconnecttest.com", "www.msftncsi.com", // Windows
    "detectportal.firefox.com",                    // Firefox
    "do-not-tracker.org"                           // EFF Cover Your Tracks: DNT-respecting tracker -> keep allowed
};
// EFF Cover Your Tracks simulated trackers (per-domain blocking model) — blocked by default.
static const char* const BLOCK_DEFAULT[] = {"trackersimulator.org", "eviltracker.net"};
static bool isDefaultBlock(const char* d) {
  for (size_t i = 0; i < sizeof(BLOCK_DEFAULT) / sizeof(BLOCK_DEFAULT[0]); i++)
    if (strcasecmp(d, BLOCK_DEFAULT[i]) == 0) return true;
  return false;
}
static bool isDefaultAllow(const char* d) {
  for (size_t i = 0; i < sizeof(ALLOW_DEFAULT) / sizeof(ALLOW_DEFAULT[0]); i++)
    if (strcasecmp(d, ALLOW_DEFAULT[i]) == 0) return true;
  return false;
}
// Encrypted-DNS (DoH/DoT) endpoints a client might use to bypass this sinkhole. We block them
// (they're in the DoH lists) AND count the attempts, so the admin sees an encrypted-DNS bypass.
static const char* const DOH_HOSTS[] = {
    "dns.google", "dns.google.com", "cloudflare-dns.com", "mozilla.cloudflare-dns.com",
    "dns.quad9.net", "doh.opendns.com", "doh.dns.sb", "dns.adguard.com", "dns.adguard-dns.com",
    "doh.cleanbrowsing.org", "dns.nextdns.io", "doh.nextdns.io", "dns.comss.one",
    "dns.digitale-gesellschaft.ch", "dnsforge.de", "doh.li", "doh.applied-privacy.net",
    "doh.ffmuc.net", "doh.mullvad.net", "dns.mullvad.net", "doh.centraleu.pi-dns.com"};
static bool isDohHost(const char* d) {
  const char* p = d;
  while (p && *p) {
    for (size_t i = 0; i < sizeof(DOH_HOSTS) / sizeof(DOH_HOSTS[0]); i++)
      if (strcasecmp(p, DOH_HOSTS[i]) == 0) return true;
    const char* dot = strchr(p, '.');
    if (!dot) break;
    const char* next = dot + 1;
    if (!strchr(next, '.')) break;
    p = next;
  }
  return false;
}
// An all-numeric, dot-separated name (an IP literal used as a hostname, e.g. a client
// resolving the resolver's own IP). Real domains never look like this, and the Bloom
// filter's ~0.8% false positives on their short suffixes were blocking such names.
static bool numericName(const char* d) {
  if (!d || !*d) return false;
  bool any = false;
  for (const char* p = d; *p;) {
    const char* q = p;
    while (*q && *q != '.') {
      if (*q < '0' || *q > '9') return false;
      q++;
    }
    if (q == p) return false; // empty label
    any = true;
    if (*q == 0) break;
    p = q + 1;
  }
  return any;
}
// Special-use / infrastructure TLDs that must never be blocked: .arpa is DNS itself
// (in-addr/ip6 reverse, home.arpa, DDR _dns.resolver.arpa); the rest are reserved names
// (RFC 2606/6761) that don't resolve anyway. Blocking them only produces false positives.
static bool specialUseTld(const char* d) {
  const char* dot = strrchr(d, '.');
  if (!dot || !dot[1]) return false;
  const char* t = dot + 1;
  return !strcasecmp(t, "arpa") || !strcasecmp(t, "localhost") || !strcasecmp(t, "test") ||
         !strcasecmp(t, "invalid") || !strcasecmp(t, "example") || !strcasecmp(t, "onion");
}
static bool isBlocked(const char* domain) {
  if (specialUseTld(domain)) return false; // never sinkhole infrastructure/reserved names
  // A runtime allow (exact or parent) or a built-in connectivity check overrides everything.
  const char* a = domain;
  while (a && *a) {
    if (isAllowDomain(a) || isDefaultAllow(a) || isTempAllowed(a)) return false;
    const char* ad = strchr(a, '.');
    if (!ad) break;
    const char* an = ad + 1;
    if (!strchr(an, '.')) break;
    a = an;
  }
  const bool numeric = numericName(domain); // IP-literal name: skip the Bloom (FP-only)
  const char* p = domain;
  while (p && *p) {
    if (isBlockDomain(p)) return true;
    if (isDefaultBlock(p)) return true;
    if (!numeric && isBlockedHash(fnv64(p, strlen(p)))) return true;
    const char* dot = strchr(p, '.');
    if (!dot) break;
    const char* next = dot + 1;
    if (!strchr(next, '.')) break;
    p = next;
  }
  if (numRgx) { // hostname regexes from a BLM2 blob (reached only on a bloom miss)
    const char* q = domain;
    while (q && *q) {
      for (uint16_t i = 0; i < numRgx; i++)
        if (hostReMatch(rgxPat[i], q)) return true;
      const char* dot = strchr(q, '.');
      if (!dot) break;
      const char* next = dot + 1;
      if (!strchr(next, '.')) break;
      q = next;
    }
  }
  if (isWildBlock(domain)) return true; // wildcard rules match the full host once
  // Opt-in keyword heuristic (fallback; only when the lists didn't match).
  if (keywordBlock && keywordHit(domain)) return true;
  return false;
}

// ---------- user rules (/rules.cfg) ----------
static void saveRules(); // fwd (add* persist)

// Shared store for the five String rule arrays (block / allow / keyword / wildcard / url):
// reject duplicates & overflow, erase in place. The per-type validation stays in each add*.
static bool rlPush(String* a, int& n, int cap, const String& v) {
  if (!v.length() || n >= cap) return false;
  for (int i = 0; i < n; i++)
    if (a[i] == v) return false;
  a[n++] = v;
  return true;
}
static void rlErase(String* a, int& n, const String& v) {
  for (int i = 0; i < n; i++)
    if (a[i] == v) {
      for (int j = i; j < n - 1; j++) a[j] = a[j + 1];
      n--;
      saveRules();
      return;
    }
}

static bool addBlock(String d, bool persist = true) {
  d.trim();
  d.toLowerCase();
  if (d.startsWith("www.")) d = d.substring(4);
  if (d.indexOf('.') < 0) return false;
  if (!rlPush(blockDom, numBlock, MAX_CUSTOM, d)) return false;
  if (persist) saveRules();
  return true;
}
static void removeBlock(String d) {
  d.trim();
  d.toLowerCase();
  if (d.startsWith("www.")) d = d.substring(4);
  rlErase(blockDom, numBlock, d);
}
static bool isAllowDomain(const char* d) {
  for (int i = 0; i < numAllow; i++)
    if (strcmp(allowDom[i].c_str(), d) == 0) return true;
  return false;
}
static bool addAllow(String d, bool persist = true) {
  d.trim();
  d.toLowerCase();
  if (d.startsWith("www.")) d = d.substring(4);
  if (d.indexOf('.') < 0) return false;
  if (!rlPush(allowDom, numAllow, MAX_ALLOW, d)) return false;
  if (persist) saveRules();
  return true;
}
// Temporary allow: not persisted, expires by itself (block page "continue for N minutes").
static bool isTempAllowed(const char* d) {
  uint32_t now = millis();
  for (int i = 0; i < MAX_TEMPALLOW; i++)
    if (tempAllow[i].host[0] && (int32_t)(tempAllow[i].until - now) > 0 && strcasecmp(tempAllow[i].host, d) == 0) return true;
  return false;
}
static void addTempAllow(String d, uint32_t ms) {
  d.trim();
  d.toLowerCase();
  if (d.startsWith("www.")) d = d.substring(4);
  if (!d.length() || d.indexOf('.') < 0) return;
  uint32_t now = millis();
  int slot = -1;
  for (int i = 0; i < MAX_TEMPALLOW; i++) {
    if (!tempAllow[i].host[0] || (int32_t)(tempAllow[i].until - now) <= 0) {
      slot = i;
      break;
    } // free/expired
    if (strcasecmp(tempAllow[i].host, d.c_str()) == 0) {
      slot = i;
      break;
    } // refresh
  }
  if (slot < 0) slot = 0;
  strncpy(tempAllow[slot].host, d.c_str(), sizeof(tempAllow[slot].host) - 1);
  tempAllow[slot].host[sizeof(tempAllow[slot].host) - 1] = 0;
  tempAllow[slot].until = now + ms;
}
static bool addKeyword(String t, bool persist = true) {
  t.trim();
  t.toLowerCase();
  if (t.indexOf('.') >= 0) return false;
  if (!rlPush(kwDom, numKw, MAX_KW, t)) return false;
  if (persist) saveRules();
  return true;
}
static bool addWild(String p, bool persist = true) {
  p.trim();
  p.toLowerCase();
  if (p.indexOf('*') < 0 || p.indexOf('.') < 0) return false;
  if (!rlPush(wildDom, numWild, MAX_WILD, p)) return false;
  if (persist) saveRules();
  return true;
}
// PAC URL-block pattern: a substring matched against the full URL by the client's PAC
// (which sees paths). Matches are routed to this device's black-hole port. No JS-unsafe chars.
static bool addUrl(String p, bool persist = true) {
  p.trim();
  // The PAC is JavaScript served to every client: allow only URL-safe characters. A quote,
  // backslash, control char or JS/PAC punctuation breaks out of the string literal — a single
  // newline is enough to make the whole PAC a syntax error (silently disabling the proxy).
  if (p.length() > 120) return false;
  for (size_t i = 0; i < p.length(); i++) {
    char ch = p[i];
    if (ch < 0x21 || ch > 0x7e) return false;                  // space, control, non-ASCII
    if (strchr("'\\\"(){};,<>`", ch)) return false;            // JS/PAC syntax
  }
  if (!rlPush(urlDom, numUrl, MAX_URL, p)) return false;
  if (persist) saveRules();
  return true;
}
static void removeAllow(String d) {
  d.trim();
  d.toLowerCase();
  if (d.startsWith("www.")) d = d.substring(4);
  rlErase(allowDom, numAllow, d);
}
static void removeKeyword(String t) {
  t.trim();
  t.toLowerCase();
  rlErase(kwDom, numKw, t);
}
static void removeWild(String p) {
  p.trim();
  p.toLowerCase();
  rlErase(wildDom, numWild, p);
}
static void saveRules() {
  File f = LittleFS.open("/rules.cfg", "w");
  if (!f) return;
  for (int i = 0; i < numBlock; i++) f.println("block " + blockDom[i]);
  for (int i = 0; i < numAllow; i++) f.println("allow " + allowDom[i]);
  for (int i = 0; i < numKw; i++) f.println("keyword " + kwDom[i]);
  for (int i = 0; i < numWild; i++) f.println("wildcard " + wildDom[i]);
  for (int i = 0; i < numUrl; i++) f.println("url " + urlDom[i]);
  f.close();
}
// First boot on this format: fold the old /custom.txt + /allow.txt into /rules.cfg and
// seed the default keywords. One-time; afterwards /rules.cfg is the source of truth.
static void migrateRules() {
  File f = LittleFS.open("/custom.txt", "r");
  if (f) {
    while (f.available()) {
      String l = f.readStringUntil('\n');
      l.trim();
      addBlock(l, false);
    }
    f.close();
  }
  f = LittleFS.open("/allow.txt", "r");
  if (f) {
    while (f.available()) {
      String l = f.readStringUntil('\n');
      l.trim();
      addAllow(l, false);
    }
    f.close();
  }
  for (size_t i = 0; i < sizeof(KW_DEFAULT) / sizeof(KW_DEFAULT[0]); i++) addKeyword(KW_DEFAULT[i], false);
  saveRules();
  Serial.println("rules: migrated old files + default keywords -> /rules.cfg");
}
static void loadRules() {
  numBlock = numAllow = numKw = numWild = numUrl = 0;
  File f = LittleFS.open("/rules.cfg", "r");
  if (!f) {
    migrateRules();
    return;
  }
  while (f.available()) {
    String l = f.readStringUntil('\n');
    l.trim();
    if (!l.length() || l[0] == '#') continue;
    if (l.startsWith("@@||")) {
      addAllow(l.substring(4), false);
      continue;
    } // AdBlock shorthand
    if (l.startsWith("||")) {
      String d = l.substring(2);
      if (d.indexOf('*') >= 0) addWild(d, false);
      else addBlock(d, false);
      continue;
    }
    int sp = l.indexOf(' ');
    String verb = (sp < 0) ? l : l.substring(0, sp);
    verb.toLowerCase();
    String val = (sp < 0) ? String("") : l.substring(sp + 1);
    val.trim();
    if (verb == "block" || verb == "b") {
      if (val.indexOf('*') >= 0) addWild(val, false);
      else addBlock(val, false);
    } else if (verb == "allow" || verb == "a") addAllow(val, false);
    else if (verb == "keyword" || verb == "k") addKeyword(val, false);
    else if (verb == "wildcard" || verb == "w") addWild(val, false);
    else if (verb == "url" || verb == "u") addUrl(val, false);
  }
  f.close();
}

// ---------- block-reply mode (/block.cfg) ----------
static void loadBlockCfg() {
  File f = LittleFS.open("/block.cfg", "r");
  if (!f) return;
  String m = f.readStringUntil('\n');
  m.trim();
  m.toLowerCase();
  String v = f.readStringUntil('\n');
  v.trim();
  String k = f.readStringUntil('\n');
  k.trim();
  String r = f.readStringUntil('\n');
  r.trim();
  String s = f.readStringUntil('\n');
  s.trim();
  String p = f.readStringUntil('\n');
  p.trim();
  String t = f.readStringUntil('\n'); // absent in older files -> keep the default
  t.trim();
  f.close();
  blockMode = (m == "zero") ? BLOCK_MODE_ZERO : (m == "nxdomain") ? BLOCK_MODE_NX
                                                                  : BLOCK_MODE_IP;
  ipv4Only = (v == "1");
  keywordBlock = (k == "1");
  rebindGuard = (r == "1");
  safeSearchMask = (uint8_t)(s.toInt() & 0xF);
  if (p.length()) secLevel = (uint8_t)constrain(p.toInt(), 0, 3); // absent in older files -> baked default
  if (t.length()) blockTtl = (uint32_t)constrain(t.toInt(), 0, 86400);
}
static void saveBlockCfg() {
  File f = LittleFS.open("/block.cfg", "w");
  if (!f) return;
  f.println(blockMode == BLOCK_MODE_ZERO ? "zero" : blockMode == BLOCK_MODE_NX ? "nxdomain"
                                                                               : "ip");
  f.println(ipv4Only ? "1" : "0");
  f.println(keywordBlock ? "1" : "0");
  f.println(rebindGuard ? "1" : "0");
  f.println(safeSearchMask);
  f.println(secLevel);
  f.println(blockTtl);
  f.close();
}

// ---------- PAC proxy (/proxy.cfg: "<host:port>", empty = direct) ----------
static String proxyAddr;
static void loadProxyCfg() {
  File f = LittleFS.open("/proxy.cfg", "r");
  if (!f) return;
  proxyAddr = f.readStringUntil('\n');
  proxyAddr.trim();
  f.close();
}
static void saveProxyCfg() {
  File f = LittleFS.open("/proxy.cfg", "w");
  if (!f) return;
  f.println(proxyAddr);
  f.close();
}

// True when no UDP query is awaiting an upstream reply (gates flash writes to idle time).
static bool dnsIdle() {
  for (int i = 0; i < INFLIGHT_N; i++)
    if (inflight[i].used) return false;
  return true;
}

// ---------- upstream selection (/dns.cfg: one IPv4 per line) ----------
// Every round probes each candidate with a tiny DNS query on its own socket (probeCli),
// so forwarding RTT (rttMs) stays pure. The pick only becomes the forwarder when no
// query is in flight: pollUpstream() matches replies against upstreamIP.
static void dnsReset() {
  dnsCount = 0;
  dnsCur = 0;
  dnsNext = -1;
  for (int i = 0; i < MAX_DNS; i++) {
    dnsRtt[i] = 0;
    dnsFails[i] = 0;
  }
}
static bool dnsAdd(String s) {
  s.trim();
  IPAddress ip;
  if (!s.length() || !ip.fromString(s) || (uint32_t)ip == 0) return false;
  for (int i = 0; i < dnsCount; i++)
    if (dnsList[i] == ip) return true; // dedupe
  if (dnsCount >= MAX_DNS) return false;
  dnsList[dnsCount++] = ip;
  return true;
}
// Accepts commas, spaces, semicolons or newlines as separators (dashboard textarea).
// Parses into a scratch list first: a bad request must not wipe the running list.
static bool dnsParseList(String csv) {
  IPAddress tmp[MAX_DNS];
  int n = 0;
  for (unsigned int i = 0; i < csv.length(); i++) {
    char ch = csv[i];
    if (ch == ';' || ch == '\n' || ch == '\r' || ch == ' ' || ch == '\t') csv.setCharAt(i, ',');
  }
  int start = 0;
  while (start < (int)csv.length() && n < MAX_DNS) {
    int sep = csv.indexOf(',', start);
    if (sep < 0) sep = csv.length();
    String one = csv.substring(start, sep);
    one.trim();
    IPAddress ip;
    if (one.length() && ip.fromString(one) && (uint32_t)ip != 0) {
      bool dup = false;
      for (int i = 0; i < n; i++)
        if (tmp[i] == ip) {
          dup = true;
          break;
        }
      if (!dup) tmp[n++] = ip;
    }
    start = sep + 1;
  }
  if (!n) return false;
  dnsReset();
  for (int i = 0; i < n; i++) dnsList[i] = tmp[i];
  dnsCount = n;
  return true;
}
static void loadDnsCfg() {
  dnsReset();
  File f = LittleFS.open("/dns.cfg", "r");
  if (f) {
    while (f.available() && dnsCount < MAX_DNS) dnsAdd(f.readStringUntil('\n'));
    f.close();
  }
  if (!dnsCount) dnsParseList(UPSTREAM_DNS_LIST);
  if (!dnsCount) {
    dnsList[0] = IPAddress(1, 1, 1, 1);
    dnsCount = 1;
  }
  dnsCur = 0;
  dnsNext = -1;
  upstreamIP = dnsList[0];
}
static void saveDnsCfg() {
  File f = LittleFS.open("/dns.cfg", "w");
  if (!f) return;
  for (int i = 0; i < dnsCount; i++) f.println(dnsList[i].toString());
  f.close();
}
static void applyDnsSwitch() {
  if (dnsNext < 0 || dnsNext >= dnsCount) return;
  if (dnsNext == dnsCur && upstreamIP == dnsList[dnsCur]) {
    dnsNext = -1;
    return;
  }
  if (!dnsIdle()) return; // never strand an in-flight reply
  dnsCur = dnsNext;
  dnsNext = -1;
  upstreamIP = dnsList[dnsCur];
  rttSum = locSum = 0;
  rttCnt = locCnt = 0;
  rttIdx = locIdx = 0; // health belongs to the old server
  for (int i = 0; i < RTT_WINDOW; i++) {
    rttRing[i] = 0;
    locRing[i] = 0;
  }
}
static uint32_t dnsProbeFails = 0; // diagnostics: probe timeouts since boot
static int dnsProbePos = -1;       // server being probed (-1 = idle)
static uint16_t dnsProbeWid = 0;
static uint32_t dnsProbeSent = 0, dnsRoundStart = 0;
static int dnsProbeNext = 0; // next server in the current round
static void sendDnsProbe(int i) {
  uint8_t q[64];
  int n = 12;
  uint16_t wid = (uint16_t)rnd32();
  if (!wid) wid = 1;
  q[0] = wid >> 8;
  q[1] = wid & 0xFF;
  q[2] = 0x01;
  q[3] = 0x00; // RD, one question
  q[4] = 0;
  q[5] = 1;
  q[6] = q[7] = q[8] = q[9] = q[10] = q[11] = 0;
  const char* p = DNS_PROBE_NAME;
  while (*p) {
    const char* dot = strchr(p, '.');
    int l = dot ? (int)(dot - p) : (int)strlen(p);
    if (l <= 0 || l > 63 || n + 1 + l >= (int)sizeof(q)) break;
    q[n++] = (uint8_t)l;
    memcpy(q + n, p, l);
    n += l;
    p += l + (dot ? 1 : 0);
  }
  q[n++] = 0;
  q[n++] = 0;
  q[n++] = 1;
  q[n++] = 0;
  q[n++] = 1; // root, A, IN
  probeCli.beginPacket(dnsList[i], UPSTREAM_PORT);
  probeCli.write(q, n);
  probeCli.endPacket();
  dnsProbeWid = wid;
  dnsProbeSent = millis();
  dnsProbePos = i;
}
static void probeDnsTick() {
  if (dnsCount < 1) return;
  const uint32_t now = millis();
  if (dnsProbePos >= 0) {
    int sz = probeCli.parsePacket();
    if (sz > 0) {
      uint32_t from = (uint32_t)probeCli.remoteIP(); // capture before read/flush
      uint8_t h[96];
      int n = probeCli.read(h, sizeof(h));
      udpDrop(probeCli);
      if (n >= 12 && from == (uint32_t)dnsList[dnsProbePos] &&
          (((h[0] << 8) | h[1]) == dnsProbeWid) && (h[2] & 0x80)) {
        uint32_t r = now - dnsProbeSent;
        if (r > 5000) r = 5000;
        dnsRtt[dnsProbePos] = (uint16_t)r;
        dnsFails[dnsProbePos] = 0;
        dnsProbePos = -1;
      }
    } else if (now - dnsProbeSent > DNS_PROBE_TIMEOUT_MS) {
      udpDrop(probeCli);
      dnsProbeFails++;
      int i = dnsProbePos;
      if (dnsFails[i] < 255) dnsFails[i]++;
      if (dnsFails[i] >= 2) dnsRtt[i] = DNS_DEAD; // two misses in a row = dead
      dnsProbePos = -1;
    }
  }
  if (dnsProbePos >= 0) return;
  if (dnsRoundStart == 0 || (uint32_t)(now - dnsRoundStart) >= DNS_PROBE_INTERVAL_MS) {
    dnsRoundStart = now;
    dnsProbeNext = 0;
  }
  if (dnsProbeNext < dnsCount) {
    sendDnsProbe(dnsProbeNext++);
    return;
  }
  int pick = pickDns(dnsRtt, dnsCount, dnsCur); // round done -> re-evaluate
  if (pick != dnsCur) dnsNext = pick;
}

// ---------- local DNS records (/hosts.cfg: "name ip") + answer own hostname ----------
struct LocalHost {
  char name[40];
  uint32_t ip;
};
static LocalHost localHosts[MAX_HOSTS];
static int numHosts = 0;
static void loadHosts() {
  numHosts = 0;
  File f = LittleFS.open("/hosts.cfg", "r");
  if (!f) return;
  while (f.available() && numHosts < MAX_HOSTS) {
    String l = f.readStringUntil('\n');
    l.trim();
    int sp = l.indexOf(' ');
    if (sp <= 0) continue;
    String n = l.substring(0, sp);
    n.trim();
    n.toLowerCase();
    IPAddress ip;
    if (n.length() && ip.fromString(l.substring(sp + 1))) {
      strncpy(localHosts[numHosts].name, n.c_str(), 39);
      localHosts[numHosts].name[39] = 0;
      localHosts[numHosts].ip = (uint32_t)ip;
      numHosts++;
    }
  }
  f.close();
}
static void saveHosts() {
  File f = LittleFS.open("/hosts.cfg", "w");
  if (!f) return;
  for (int i = 0; i < numHosts; i++) {
    IPAddress ip(localHosts[i].ip);
    f.println(String(localHosts[i].name) + " " + ip.toString());
  }
  f.close();
}
static bool setHost(String n, String a) {
  n.trim();
  n.toLowerCase();
  if (n.startsWith("www.")) n = n.substring(4);
  a.trim();
  IPAddress ip;
  if (!n.length() || n.length() > 39 || n.indexOf('.') < 0 || !ip.fromString(a)) return false;
  for (int i = 0; i < numHosts; i++)
    if (n.equalsIgnoreCase(localHosts[i].name)) {
      localHosts[i].ip = (uint32_t)ip;
      saveHosts();
      return true;
    }
  if (numHosts >= MAX_HOSTS) return false;
  strncpy(localHosts[numHosts].name, n.c_str(), 39);
  localHosts[numHosts].name[39] = 0;
  localHosts[numHosts].ip = (uint32_t)ip;
  numHosts++;
  saveHosts();
  return true;
}
static bool delHost(String n) {
  n.trim();
  n.toLowerCase();
  for (int i = 0; i < numHosts; i++)
    if (n.equalsIgnoreCase(localHosts[i].name)) {
      for (int j = i; j < numHosts - 1; j++) localHosts[j] = localHosts[j + 1];
      numHosts--;
      saveHosts();
      return true;
    }
  return false;
}
static bool lookupHost(const char* d, uint32_t& ip) {
  for (int i = 0; i < numHosts; i++)
    if (strcasecmp(localHosts[i].name, d) == 0) {
      ip = localHosts[i].ip;
      return true;
    }
  // "Am I using this resolver?" probe: answer any *.dnscheck name with our own IP, locally.
  // The dashboard fetches http://<random>.dnscheck/__dnscheck — it only resolves if the
  // client's DNS path goes through us (an invented TLD, so nothing else can answer it).
  {
    size_t n = strlen(d);
    if (n > 9 && strcasecmp(d + n - 9, ".dnscheck") == 0) {
      ip = (uint32_t)WiFi.localIP();
      return true;
    }
  }
  if (cfgHost.length()) { // the device's own name (.local too)
    if (strcasecmp(cfgHost.c_str(), d) == 0) {
      ip = (uint32_t)WiFi.localIP();
      return true;
    }
    String dot = cfgHost + ".local";
    if (dot.equalsIgnoreCase(d)) {
      ip = (uint32_t)WiFi.localIP();
      return true;
    }
  }
  return false;
}

// ---------- SafeSearch: answer provider consumer domains with the enforcing IP ----------
// IPs (2026, verified): Google forcesafesearch 216.239.38.120; YouTube restrictmoderate
// 216.239.38.119; Bing strict 150.171.27.16; DuckDuckGo safe 191.235.126.53. AAAA is not
// answered by these hosts, so ipv4Only (NODATA) must stay on or IPv6 clients bypass this.
#define IP4(a, b, c, d) ((uint32_t)(a) | ((uint32_t)(b) << 8) | ((uint32_t)(c) << 16) | ((uint32_t)(d) << 24))
static const struct SafeHost {
  const char* host;
  uint8_t bit;
  uint32_t ip;
} SAFE_HOSTS[] = {
    {"youtube.com", SS_YOUTUBE, IP4(216, 239, 38, 119)}, {"m.youtube.com", SS_YOUTUBE, IP4(216, 239, 38, 119)}, {"youtube-nocookie.com", SS_YOUTUBE, IP4(216, 239, 38, 119)}, {"youtubei.googleapis.com", SS_YOUTUBE, IP4(216, 239, 38, 119)}, {"youtube.googleapis.com", SS_YOUTUBE, IP4(216, 239, 38, 119)}, {"bing.com", SS_BING, IP4(150, 171, 27, 16)}, {"edgeservices.bing.com", SS_BING, IP4(150, 171, 27, 16)}, {"duckduckgo.com", SS_DDG, IP4(191, 235, 126, 53)}, {"start.duckduckgo.com", SS_DDG, IP4(191, 235, 126, 53)}};
static uint32_t safeSearchIP(const char* d) {
  if (!safeSearchMask) return 0;
  const char* h = d;
  if (strncmp(h, "www.", 4) == 0) h += 4; // www.<x> → <x>
  if ((safeSearchMask & SS_GOOGLE) && strncmp(h, "google.", 7) == 0 && strlen(h) > 7) return IP4(216, 239, 38, 120);
  for (size_t i = 0; i < sizeof(SAFE_HOSTS) / sizeof(SAFE_HOSTS[0]); i++)
    if ((safeSearchMask & SAFE_HOSTS[i].bit) && strcasecmp(h, SAFE_HOSTS[i].host) == 0) return SAFE_HOSTS[i].ip;
  return 0;
}
static bool macZero(const uint8_t* m) { return !(m[0] | m[1] | m[2] | m[3] | m[4] | m[5]); }
static void getMac(uint32_t ip, uint8_t* mac) {
  memset(mac, 0, 6);
  ip4_addr_t ipa;
  ipa.addr = ip;
  struct eth_addr* eth = nullptr;
  const ip4_addr_t* ipret = nullptr;
  for (struct netif* nif = netif_list; nif; nif = nif->next)
    if (etharp_find_addr(nif, &ipa, &eth, &ipret) >= 0 && eth) {
      memcpy(mac, eth->addr, 6);
      return;
    }
}
// Actively resolve `ip` so its MAC lands in the ARP cache. Needed because a client
// that sends a single DNS query is otherwise never looked up again (getClient only
// runs on the DNS path), leaving its MAC 00:00:00:00:00:00 forever. Passive: fills
// the cache asynchronously; the next getMac/stats poll reads the reply.
static void requestMac(uint32_t ip) {
  ip4_addr_t ipa;
  ipa.addr = ip;
  struct netif* best = nullptr;
  for (struct netif* nif = netif_list; nif; nif = nif->next)
    if (ip4_addr_netcmp(&ipa, ip_2_ip4(&nif->ip_addr), ip_2_ip4(&nif->netmask))) { best = nif; break; }
  if (!best) best = netif_list;                       // unknown subnet: try the first netif
  if (best) etharp_query(best, &ipa, nullptr);        // q == NULL -> send an ARP request only
}
static Dev* getClient(uint32_t ip) {
  for (int i = 0; i < numClients; i++)
    if (clients[i].ip == ip) {
      clients[i].lastSeen = millis();
      if (macZero(clients[i].mac)) {
        getMac(ip, clients[i].mac);          // wasn't in the ARP cache when first seen — retry now
        if (macZero(clients[i].mac)) requestMac(ip);
      }
      return &clients[i];
    }
  if (numClients < MAX_CLIENTS) {
    Dev* c = &clients[numClients++];
    c->ip = ip;
    c->blocked = c->allowed = 0;
    c->pac = 0;
    c->lastSeen = millis();
    c->qps = 0;
    c->win = 0;
    c->pausedUntil = 0;
    getMac(ip, c->mac);
    if (macZero(c->mac)) requestMac(ip);   // fill the ARP cache so the MAC shows on the next poll
    return c;
  }
  int oldest = 0; // full: evict the least-recently-seen
  for (int i = 1; i < numClients; i++)
    if (clients[i].lastSeen < clients[oldest].lastSeen) oldest = i;
  Dev* c = &clients[oldest];
  c->ip = ip;
  c->blocked = c->allowed = 0;
  c->pac = 0;
  c->lastSeen = millis();
  c->qps = 0;
  c->win = 0;
  c->pausedUntil = 0;
  getMac(ip, c->mac);
  if (macZero(c->mac)) requestMac(ip);
  return c;
}
// A paused scope must disable EVERY blocking path (direct DNS, CNAME cloaking, block
// page, PAC url rules), not just the isBlocked() call in localAnswer().
static inline bool clientPaused(uint32_t ip) {
  for (int i = 0; i < numClients; i++)
    if (clients[i].ip == ip)
      return clients[i].pausedUntil && (int32_t)(clients[i].pausedUntil - millis()) > 0;
  return false;
}
static inline bool blockingActiveFor(uint32_t ip) { return blockingOn && !clientPaused(ip); }

// ---------- DNS ----------
// Authoritative A answer for a local record (non-A -> NOERROR/NODATA).
static int buildAnswer(int qend, IPAddress ip, uint16_t qtype) {
  buf[2] = 0x81;
  buf[3] = 0x80;
  buf[6] = buf[8] = buf[9] = buf[10] = buf[11] = 0;
  buf[7] = (qtype == 1) ? 1 : 0;
  if (qtype != 1) return qend;
  const uint8_t ans[] = {0xC0, 0x0C, 0, 1, 0, 1, 0, 0, 0, 0x3C, 0, 4, ip[0], ip[1], ip[2], ip[3]};
  if (qend + (int)sizeof(ans) > (int)sizeof(buf)) return qend;
  memcpy(buf + qend, ans, sizeof(ans));
  return qend + sizeof(ans);
}
// #12 DNS-rebinding guard: a public name must not resolve to a private/reserved address.
static bool isPrivateIP(const uint8_t* p) {
  if (p[0] == 10 || p[0] == 127 || p[0] >= 224) return true;
  if (p[0] == 192 && p[1] == 168) return true;
  if (p[0] == 172 && p[1] >= 16 && p[1] <= 31) return true;
  if (p[0] == 169 && p[1] == 254) return true;
  return false;
}
static bool isPrivateIP6(const uint8_t* p) {
  if (p[0] == 0xFF) return true;                          // ff00::/8 multicast
  if ((p[0] & 0xFE) == 0xFC) return true;                 // fc00::/7 unique local
  if (p[0] == 0xFE && (p[1] & 0xC0) == 0x80) return true; // fe80::/10 link-local
  bool zero = true, loop = (p[15] == 1);
  for (int i = 0; i < 16; i++)
    if (p[i]) {
      zero = false;
      break;
    }
  if (zero) return true; // ::
  if (loop) {
    bool l = true;
    for (int i = 0; i < 15; i++)
      if (p[i]) {
        l = false;
        break;
      }
    if (l) return true;
  }                                                                          // ::1
  static const uint8_t v4m[12] = {0, 0, 0, 0, 0, 0, 0, 0, 0, 0, 0xFF, 0xFF}; // ::ffff:a.b.c.d
  bool mapped = true;
  for (int i = 0; i < 12; i++)
    if (p[i] != v4m[i]) {
      mapped = false;
      break;
    }
  if (mapped) return isPrivateIP(p + 12);
  return false;
}
static bool answerHasPrivateIP(const uint8_t* p, int n, int qend) {
  int i = qend;
  uint16_t ancount = (p[6] << 8) | p[7];
  for (int a = 0; a < ancount && a < 32; a++) {
    if (i + 2 > n) break;
    if ((p[i] & 0xC0) == 0xC0) i += 2;
    else {
      bool ptr = false;
      while (i < n && p[i]) {
        if (p[i] & 0xC0) {
          i += 2;
          ptr = true;
          break;
        }
        i += 1 + p[i];
      }
      if (!ptr && i < n) i += 1;
    }
    if (i + 10 > n) break;
    uint16_t type = (p[i] << 8) | p[i + 1], rdlen = (p[i + 8] << 8) | p[i + 9];
    int rdata = i + 10;
    if (rdata + rdlen > n) break;
    if (type == 1 && rdlen == 4 && isPrivateIP(p + rdata)) return true;    // A
    if (type == 28 && rdlen == 16 && isPrivateIP6(p + rdata)) return true; // AAAA
    i = rdata + rdlen;
  }
  return false;
}
// Record a blocked lookup in the ring (frontend polls it). Cheap: no string history kept.
// Burst strategy: a host already in the ring (last 10 s) folds into its entry (count++) and is
// re-stamped as the newest, so a flood of one host cannot evict the other 15 slots — and the
// client, polling by cursor, re-reads it with the updated count instead of 500 duplicates.
static void pushBlocked(const char* host, uint32_t cip) {
  uint16_t count = 1;
  for (int i = 0; i < EV_N; i++) {
    BlockEv& o = evRing[i];
    if (!o.seq || strcmp(o.host, host) != 0) continue;
    if ((uint32_t)(millis() - o.ts) > 10000UL) continue; // stale: keep as separate history
    if (o.count < 0xFFFE) count = o.count + 1;
    o.seq = 0; // vacated: the new head carries the folded count
    break;
  }
  evSeq++;
  BlockEv& e = evRing[evSeq % EV_N];
  e.seq = evSeq;
  e.ts = millis();
  e.cip = cip;
  e.count = count;
  strncpy(e.host, host, sizeof(e.host) - 1);
  e.host[sizeof(e.host) - 1] = 0;
}
static size_t parseQuery(const uint8_t* pkt, int len, char* out, uint16_t* qtype, int* qend) {
  if (len < 13) return 0;
  int i = 12;
  size_t o = 0;
  while (i < len) {
    uint8_t l = pkt[i++];
    if (l == 0) break;
    if (l & 0xC0) return 0;
    if (o + l + 1 >= 250 || i + l > len) return 0;
    if (o) out[o++] = '.';
    for (uint8_t k = 0; k < l; k++) out[o++] = tolower(pkt[i++]);
  }
  out[o] = 0;
  if (i + 4 > len) return 0;
  *qtype = (pkt[i] << 8) | pkt[i + 1];
  *qend = i + 4;
  return o;
}
static int buildBlocked(int qend, uint16_t qtype) {
  if (blockMode == BLOCK_MODE_NX) { // NXDOMAIN: no answer, RCODE=3
    buf[2] = 0x81;
    buf[3] = 0x83;
    buf[6] = 0;
    buf[7] = 0;
    buf[8] = 0;
    buf[9] = 0;
    buf[10] = 0;
    buf[11] = 0;
    return qend;
  }
  buf[2] = 0x81;
  buf[3] = 0x80;
  buf[6] = 0;
  buf[7] = (qtype == 1) ? 1 : 0;
  buf[8] = 0;
  buf[9] = 0;
  buf[10] = 0;
  buf[11] = 0;
  if (qtype != 1) return qend;
  IPAddress ip = (blockMode == BLOCK_MODE_ZERO) ? IPAddress(0, 0, 0, 0) : WiFi.localIP();
  const uint8_t ans[] = {0xC0, 0x0C, 0, 1, 0, 1,
                         (uint8_t)(blockTtl >> 24), (uint8_t)(blockTtl >> 16), (uint8_t)(blockTtl >> 8), (uint8_t)blockTtl,
                         0, 4, ip[0], ip[1], ip[2], ip[3]};
  if (qend + (int)sizeof(ans) > (int)sizeof(buf)) return qend;
  memcpy(buf + qend, ans, sizeof(ans));
  return qend + sizeof(ans);
}
// Non-blocking forwarder. A query is sent upstream immediately and remembered in a
// small in-flight table; pollUpstream() matches the reply by our random txid and relays
// it to the originating client. This removes the old 1 s synchronous stall (which froze
// web/OTA and serialized every query) and the txid match also drops late/unsolicited
// replies (the issue #10 cross-talk, previously handled by draining the socket).
static void sendUpstream(int qlen, uint16_t cid, uint32_t cip, uint16_t cport, uint16_t qend, uint32_t key) {
  int slot = -1;
  for (int i = 0; i < INFLIGHT_N; i++)
    if (!inflight[i].used) {
      slot = i;
      break;
    }
  if (slot < 0) return; // table full -> drop; client retries
  uint16_t wid = (uint16_t)rnd32();
  for (int t = 0; t < 8; t++) { // ensure a unique txid inside the table
    bool clash = false;
    for (int i = 0; i < INFLIGHT_N; i++)
      if (inflight[i].used && inflight[i].wid == wid) {
        clash = true;
        break;
      }
    if (!clash) break;
    wid = (uint16_t)rnd32();
  }
  InFlight& f = inflight[slot];
  f.used = true;
  f.wid = wid;
  f.cid = cid;
  f.cip = cip;
  f.cport = cport;
  f.qend = qend;
  f.key = key;
  f.sentAt = millis();
  f.t0 = millis();
  buf[0] = wid >> 8;
  buf[1] = wid & 0xFF;
  upstreamCli.beginPacket(upstreamIP, UPSTREAM_PORT);
  upstreamCli.write(buf, qlen);
  upstreamCli.endPacket();
}
// TTL (seconds) of the first answer RR, clamped. Common case: the answer name is a
// compression pointer, so the record's fixed fields start right after the 2-byte pointer.
static uint32_t answerTTL(const uint8_t* p, int n, int qend) {
  int i = qend;
  if (i + 2 > n) return 60;
  if ((p[i] & 0xC0) == 0xC0) i += 2;
  else {
    bool ptr = false;
    while (i < n && p[i] != 0) {
      if (p[i] & 0xC0) {
        i += 2;
        ptr = true;
        break;
      }
      i += 1 + p[i];
    }
    if (!ptr && i < n) i += 1;
  }
  if (i + 8 > n) return 60;
  uint32_t ttl = ((uint32_t)p[i + 4] << 24) | ((uint32_t)p[i + 5] << 16) | ((uint32_t)p[i + 6] << 8) | p[i + 7];
  if (ttl < 30) ttl = 30;
  if (ttl > 3600) ttl = 3600;
  return ttl;
}
// --- DNS name/RR helpers (answers may use compression pointers) ---
static int skipName(const uint8_t* p, int n, int off) {
  while (off >= 0 && off < n) {
    uint8_t l = p[off];
    if (l == 0) return off + 1;
    if ((l & 0xC0) == 0xC0) return (off + 2 <= n) ? off + 2 : -1;
    off += 1 + l;
  }
  return -1;
}
// First public A record in an upstream answer, for the destination map. Reuses skipName;
// private/reserved A records are skipped (a sinkholed or LAN answer is not a destination).
static bool firstAPublic(const uint8_t* p, int n, int qend, uint32_t* out) {
  int i = qend;
  uint16_t an = (uint16_t)((p[6] << 8) | p[7]);
  for (int a = 0; a < an && a < 32; a++) {
    i = skipName(p, n, i);
    if (i < 0 || i + 10 > n) return false;
    uint16_t type = (uint16_t)((p[i] << 8) | p[i + 1]);
    uint16_t rdlen = (uint16_t)((p[i + 8] << 8) | p[i + 9]);
    int rdata = i + 10;
    if (rdata + rdlen > n) return false;
    if (type == 1 && rdlen == 4 && !isPrivateIP(p + rdata)) {
      *out = ((uint32_t)p[rdata] << 24) | ((uint32_t)p[rdata + 1] << 16) |
             ((uint32_t)p[rdata + 2] << 8) | p[rdata + 3];
      return true;
    }
    i = rdata + rdlen;
  }
  return false;
}
// Count the estimated destination country of an allowed answer. O(1): one byte in flash.
static void noteGeo(const uint8_t* p, int n, int qend) {
  uint32_t ip;
  if (!firstAPublic(p, n, qend, &ip)) return;
  uint8_t cc = pgm_read_byte(&GEO_TABLE[ip >> 18]);
  if (cc >= GEO_NCODES) return; // 255 = mixed/unknown -> neutral on the map
  geoHits[cc]++;
  geoMapped++;
}
static int readName(const uint8_t* p, int n, int off, char* out, int outSz) {
  int o = 0, next = off, jumps = 0;
  bool jumped = false;
  while (off >= 0 && off < n) {
    uint8_t l = p[off];
    if (l == 0) {
      out[o] = 0;
      return jumped ? next : off + 1;
    }
    if ((l & 0xC0) == 0xC0) {
      if (off + 1 >= n) return -1;
      if (!jumped) {
        next = off + 2;
        jumped = true;
      }
      if (++jumps > 16) return -1;
      off = ((l & 0x3F) << 8) | p[off + 1];
      continue;
    }
    if (off + 1 + l > n) return -1; // label extends past the packet
    if (o + (o ? 1 : 0) + l + 1 > outSz) return -1;
    if (o) out[o++] = '.';
    for (int k = 0; k < l; k++) out[o++] = (char)tolower(p[off + 1 + k]);
    off += 1 + l;
  }
  return -1;
}
// CNAME-cloaking defense: if an answer CNAME points at a blocklisted name, treat the whole
// reply as blocked. Trackers hide behind a first-party CNAME (tracker.site.com -> vendor.tracker.com);
// the client only queried the site's own name, which a plain DNS lookup never matches.
static bool cnameBlocked(const uint8_t* p, int n, int qend, char* out, int outSz) {
  int an = (p[6] << 8) | p[7];
  int off = qend;
  for (int i = 0; i < an; i++) {
    off = skipName(p, n, off);
    if (off < 0 || off + 10 > n) return false;
    uint16_t type = (p[off] << 8) | p[off + 1];
    uint16_t rdlen = (p[off + 8] << 8) | p[off + 9];
    int rdata = off + 10;
    if (rdata + rdlen > n) return false;
    if (type == 5 && rdlen > 1 && readName(p, n, rdata, out, outSz) > 0 && isBlocked(out)) return true;
    off = rdata + rdlen;
  }
  return false;
}
// Rewrite every answer RR's TTL down to `cap` seconds so a new block/allow takes effect fast
// (clients cache the answer). The response cache stores the clamped TTL too.
static void clampTTL(uint8_t* p, int n, int qend, uint32_t cap) {
  if (!cap || n < 12 || (p[2] & 0x02)) return; // 0x02 = TC (truncated): leave it
  int an = (p[6] << 8) | p[7];
  int off = qend;
  for (int i = 0; i < an; i++) {
    off = skipName(p, n, off);
    if (off < 0 || off + 10 > n) return;
    uint32_t ttl = ((uint32_t)p[off + 4] << 24) | ((uint32_t)p[off + 5] << 16) | ((uint32_t)p[off + 6] << 8) | p[off + 7];
    if (ttl > cap) {
      p[off + 4] = (uint8_t)(cap >> 24);
      p[off + 5] = (uint8_t)(cap >> 16);
      p[off + 6] = (uint8_t)(cap >> 8);
      p[off + 7] = (uint8_t)cap;
    }
    off = off + 10 + ((p[off + 8] << 8) | p[off + 9]);
  }
}
// Shared counters for the DNS paths below (one place to bump total + per-client).
static inline void markAllowed(Dev* c) {
  totalAllowed++;
  if (c) c->allowed++;
}
static inline void markBlocked(Dev* c) {
  totalBlocked++;
  if (c) c->blocked++;
}
static void pollUpstream() {
  for (int budget = 0; budget < 16; budget++) {
    int sz = upstreamCli.parsePacket();
    if (sz <= 0) break;
    if (!(upstreamCli.remoteIP() == upstreamIP && upstreamCli.remotePort() == UPSTREAM_PORT)) {
      udpDrop(upstreamCli);
      continue;
    }
    int n = upstreamCli.read(buf, sizeof(buf));
    udpDrop(upstreamCli);
    if (n < 12 || sz > (int)sizeof(buf)) continue;
    uint16_t wid = (buf[0] << 8) | buf[1];
    int slot = -1;
    for (int i = 0; i < INFLIGHT_N; i++)
      if (inflight[i].used && inflight[i].wid == wid) {
        slot = i;
        break;
      }
    if (slot < 0) continue;      // late / unsolicited -> drop
    InFlight f = inflight[slot]; // copy out before marking free
    inflight[slot].used = false;
    dnsFails[dnsCur] = 0; // the active resolver just answered
    dnssecSeen++;         // DNSSEC telemetry: upstream set AD (validated) on this reply?
    if (buf[3] & 0x20) dnssecOk++;
    {
      uint32_t r = millis() - f.sentAt;
      if (r > 5000) r = 5000; // windowed average of upstream RTT
      rttSum -= rttRing[rttIdx];
      rttRing[rttIdx] = (uint16_t)r;
      rttSum += r;
      rttIdx = (rttIdx + 1) % RTT_WINDOW;
      if (rttCnt < RTT_WINDOW) rttCnt++;
      rttMs = rttSum / rttCnt;
      uint32_t total = millis() - f.t0;         // end-to-end as seen by the client
      uint32_t loc = total > r ? total - r : 0; // everything that isn't the upstream wait
      locSum -= locRing[locIdx];
      locRing[locIdx] = (uint16_t)loc;
      locSum += loc;
      locIdx = (locIdx + 1) % RTT_WINDOW;
      if (locCnt < RTT_WINDOW) locCnt++;
      locMs = locSum / locCnt;
    }
    if (rebindGuard && answerHasPrivateIP(buf, n, f.qend)) { // opt-in: fail clean instead of leaking a private IP
      buf[0] = f.cid >> 8;
      buf[1] = f.cid & 0xFF;
      buf[2] = 0x81;
      buf[3] = 0x83;                                             // QR=1 RD=1 RA=1, RCODE=3 (NXDOMAIN)
      buf[6] = buf[7] = buf[8] = buf[9] = buf[10] = buf[11] = 0; // no answer/authority/additional
      dnsServer.beginPacket(IPAddress(f.cip), f.cport);
      dnsServer.write(buf, f.qend);
      dnsServer.endPacket();
      continue;
    }
    char cn[256];
    // Pause scopes apply here too: a paused client (or a global pause) must not get a
    // CNAME-cloaked answer rewritten into a block.
    if (blockingActiveFor(f.cip) && cnameBlocked(buf, n, f.qend, cn, sizeof(cn))) { // CNAME cloaking: target is blocklisted
      // Answer with the normal block path so BLOCK_MODE (ip / zero / nxdomain) is honoured.
      buf[0] = f.cid >> 8; // restore the client's transaction id
      buf[1] = f.cid & 0xFF;
      uint16_t qt = (f.qend >= 4) ? (uint16_t)((buf[f.qend - 4] << 8) | buf[f.qend - 3]) : 1;
      int blen = buildBlocked(f.qend, qt);
      dnsServer.beginPacket(IPAddress(f.cip), f.cport);
      dnsServer.write(buf, blen);
      dnsServer.endPacket();
      markBlocked(getClient(f.cip));
      pushBlocked(cn, f.cip);
      continue;
    }
    noteGeo(buf, n, f.qend);             // estimated destination, before the TTL rewrite
    clampTTL(buf, n, f.qend, TTL_CLAMP_S); // fast policy changes (clients cache answers)
    if (f.key && n <= RESP_MAX) { // cache the reply (TTL-clamped)
      RespCache<RESP_CACHE_N, RESP_MAX>::Entry* s = respCache.insert(f.key, millis());
      s->key = f.key;
      s->expiry = millis() + answerTTL(buf, n, f.qend) * 1000UL;
      s->len = (uint16_t)n;
      memcpy(s->data, buf, n);
    }
    buf[0] = f.cid >> 8;
    buf[1] = f.cid & 0xFF; // restore the client's txid
    dnsServer.beginPacket(IPAddress(f.cip), f.cport);
    dnsServer.write(buf, n);
    dnsServer.endPacket();
  }
  const uint32_t now = millis(); // expire queries the upstream never answered
  for (int i = 0; i < INFLIGHT_N; i++)
    if (inflight[i].used && now - inflight[i].sentAt > 1500) {
      inflight[i].used = false;
      dnsTimeouts++;
      // Real traffic is the fastest failure signal: two unanswered lookups in a row and
      // the active resolver is treated as dead (applyDnsSwitch() then moves us when idle).
      if (dnsFails[dnsCur] < 255 && ++dnsFails[dnsCur] >= 2) {
        dnsRtt[dnsCur] = DNS_DEAD;
        int pick = pickDns(dnsRtt, dnsCount, dnsCur);
        if (pick != dnsCur) dnsNext = pick;
      }
    }
}
// WPAD only for the device's own names: "wpad", "wpad.local", "wpad.<host>", "wpad.<host>.local".
// Deliberately NOT "wpad.<any domain>" — claiming every wpad.* is a global WPAD claim that can
// poison other networks' auto-discovery (and is a classic spoofing vector).
static bool isWpadName(const char* d) {
  if (strcasecmp(d, "wpad") == 0 || strcasecmp(d, "wpad.local") == 0) return true;
  const char* host = cfgHost.length() ? cfgHost.c_str() : WIFI_HOST;
  if (!host || !*host) return false;
  char a[64], b[64];
  snprintf(a, sizeof(a), "wpad.%s", host);
  snprintf(b, sizeof(b), "wpad.%s.local", host);
  return strcasecmp(d, a) == 0 || strcasecmp(d, b) == 0;
}
// Drain a whole RX burst per call (capped, so web/OTA still get a turn).
// Classify a parsed query and answer it locally when possible — IPv4-only AAAA strip,
// local record, SafeSearch, or a block. Returns the reply length in `buf` (>0), or 0 to
// forward upstream. Shared by the UDP (handleDns) and TCP (handleTcpDns) paths.
static int localAnswer(Dev* c, uint32_t cip, const char* domain, size_t dl, uint16_t qtype, int qend) {
  if (ipv4Only && qtype == 28) {
    markAllowed(c);
    return buildAnswer(qend, IPAddress(0, 0, 0, 0), 28);
  }
  // WPAD: answer "wpad"/"wpad.*" with this device so browsers auto-find /wpad.dat (the PAC).
  if (dl && isWpadName(domain)) {
    markAllowed(c);
    return buildAnswer(qend, WiFi.localIP(), qtype);
  }
  uint32_t lip;
  if (dl && lookupHost(domain, lip)) {
    markAllowed(c);
    return buildAnswer(qend, IPAddress(lip), qtype);
  }
  uint32_t ssip;
  if (dl && (ssip = safeSearchIP(domain))) {
    markAllowed(c);
    return buildAnswer(qend, IPAddress(ssip), qtype);
  }
  bool paused = c && c->pausedUntil && (int32_t)(c->pausedUntil - millis()) > 0;
  if (blockingOn && dl && !paused && isBlocked(domain)) { // per-client pause bypasses blocking
    int rlen = buildBlocked(qend, qtype);
    markBlocked(c);
    digitalWrite(LED_PIN, LED_ON);
    ledUntil = millis() + LED_BLINK_MS; // status LED blink
    pushBlocked(dl ? domain : "?", cip);
    return rlen;
  }
  markAllowed(c);
  return 0; // forward upstream
}
// GAFM classification: suffix walk against the tiny provider Blooms loaded from the bin.
static bool gafamMember(int p, const char* d) {
  if (!gafamOk || !gafamLen[p]) return false;
  uint64_t h = fnv64(d, strlen(d));
  uint32_t a = (uint32_t)(h >> 32), b = (uint32_t)h, m = (uint32_t)gafamLen[p] * 8;
  const uint8_t* bm = gafamBuf + gafamOff[p];
  for (uint8_t i = 0; i < BLOOM_K; i++) {
    uint32_t bit = (uint32_t)(a + (uint32_t)i * b) % m;
    if (!((bm[bit >> 3] >> (bit & 7)) & 1)) return false;
  }
  return true;
}
static int gafamOf(const char* domain) {
  if (!gafamOk) return -1;
  const char* p = domain;
  while (p && *p) {
    for (int i = 0; i < 5; i++)
      if (gafamMember(i, p)) return i;
    const char* dot = strchr(p, '.');
    if (!dot) break;
    const char* next = dot + 1;
    if (!strchr(next, '.')) break;
    p = next;
  }
  return -1;
}
static bool handleDns() {
  bool did = false;
  for (int budget = 0; budget < 16; budget++) {
    int sz = dnsServer.parsePacket();
    if (sz <= 0) break;
    did = true;
    stQueries++;
    cpu_gov::markActivity();
    lastDnsMs = millis();
    IPAddress cip = dnsServer.remoteIP();
    uint16_t cport = dnsServer.remotePort();
    int qlen = dnsServer.read(buf, sizeof(buf));
    if (qlen < 13) continue;
    char domain[256];
    uint16_t qtype = 0;
    int qend = qlen;
    size_t dl = parseQuery(buf, qlen, domain, &qtype, &qend);
    // #12: only answer clients on our own subnet (check before allocating a client slot).
    const uint32_t mask = (uint32_t)WiFi.subnetMask();
    if (((uint32_t)cip & mask) != ((uint32_t)WiFi.localIP() & mask)) continue;
    Dev* c = getClient((uint32_t)cip);
    if (dl && isDohHost(domain)) dohHits++; // a client is trying an encrypted-DNS bypass
    // #12: per-client rate limit (queries/second).
    const uint32_t nowq = millis();
    if (c) {
      if (nowq - c->win > 1000) {
        c->win = nowq;
        c->qps = 0;
      }
      if (++c->qps > 200) continue;
    }
    // Local answer (IPv4-only / local record / SafeSearch / block), else forward upstream.
    int rlen = localAnswer(c, (uint32_t)cip, domain, dl, qtype, qend);
    if (rlen > 0) {
      dnsServer.beginPacket(cip, cport);
      dnsServer.write(buf, rlen);
      dnsServer.endPacket();
      continue;
    }
    if (dl) { // allowed lookup: attribute it to a provider for the GAFAM telemetry
      int gp = gafamOf(domain);
      gafamCnt[gp >= 0 ? gp : 5]++;
    }
    const uint16_t cid = (uint16_t)((buf[0] << 8) | buf[1]);
    uint32_t key = dl ? ((uint32_t)fnv64(domain, strlen(domain)) ^ (uint32_t)(qtype * 0x9E3779B1u)) : 0;
    if (key) { // serve from the response cache if fresh
      RespCache<RESP_CACHE_N, RESP_MAX>::Entry* s = respCache.find(key, millis());
      if (s) {
        uint16_t len = s->len;
        memcpy(buf, s->data, len);
        buf[0] = cid >> 8;
        buf[1] = cid & 0xFF;
        noteGeo(buf, len, qend); // same answer a fresh resolve would have counted
        dnsServer.beginPacket(cip, cport);
        dnsServer.write(buf, len);
        dnsServer.endPacket();
        totalCached++;
        stRespCached++;
        continue;
      }
    }
    sendUpstream(qlen, cid, (uint32_t)cip, cport, (uint16_t)qend, key);
  }
  return did;
}

// TCP :53 fallback. A client retries over TCP when a UDP reply sets the TC (truncated) bit
// — large/EDNS answers — and some query TCP directly. Today the UDP forwarder relays TC=1
// as-is, so without this the retry would fail. The state machine lives in concurrency.h
// (single-owner, driven by loop()); only the upstream connect() is still bounded-blocking.
static int tcpResolve(void* user, const IPAddress& peer, uint8_t* msg, int len, int* qend) {
  (void)user;
  // localAnswer()/buildAnswer()/buildBlocked() write to the shared DNS scratch buffer
  // (`buf`), not to the relay's. Copy in/out: without this a locally-answered TCP query
  // would send the query bytes back. The whole call is one poll() step, so no yield.
  if (len <= 0 || len > (int)sizeof(buf)) return -1;
  memcpy(buf, msg, len);
  char domain[256];
  uint16_t qtype = 0;
  int qe = len;
  size_t dl = parseQuery(buf, len, domain, &qtype, &qe);
  *qend = qe;
  int rlen = localAnswer(getClient((uint32_t)peer), (uint32_t)peer, domain, dl, qtype, qe);
  if (rlen > 0 && rlen <= (int)sizeof(buf)) memcpy(msg, buf, rlen);
  return rlen;
}
static void tcpReplied(void* user, uint8_t* msg, int len, int qend, bool forwarded) {
  (void)user;
  if (forwarded) noteGeo(msg, len, qend); // relayed answers keep the query's question offset
}
// Accept a PAC-routed URL and drop it at once: the resource (HTTP) or its TLS CONNECT
// (HTTPS) fails to complete, so the client treats it as blocked. No content is served, so
// no certificates/MITM are involved; only the URLs the client's PAC matched hit this port.
static void handleBlackhole() {
  WiFiClient c = blackhole.accept();
  if (!c) return;
  // A request on this port can only come from a client whose PAC routed a matched URL here
  // => it is using the PAC. Record it per client (and globally) so the dashboard can tell a
  // PAC client apart from a DNS-only one. DNS itself gives no such signal.
  // Only count IPs already known from DNS: a port scan of :81 (or any LAN host that never
  // queried us) must not create client entries, push the table to MAX_CLIENTS, or look like
  // PAC usage. DNS itself gives the only trustworthy signal that a client exists.
  uint32_t rip = (uint32_t)c.remoteIP();
  for (int i = 0; i < numClients; i++)
    if (clients[i].ip == rip) {
      pacHits++;
      clients[i].pac++;
      break;
    }
  c.stop();
}

// ---------- web ----------
static String macStr(const uint8_t* m) {
  char s[18];
  snprintf(s, sizeof(s), "%02x:%02x:%02x:%02x:%02x:%02x", m[0], m[1], m[2], m[3], m[4], m[5]);
  return String(s);
}
// ---------- friendly client names (/names.cfg: "<ip> <name>") ----------
static String nameForIp(uint32_t ip) {
  for (int i = 0; i < numNames; i++)
    if (clientNames[i].ip == ip) return clientNames[i].name;
  return String("");
}
static String jesc(const String& s); // fwd (defined with the JSON helpers below)
// Side-effect-free MAC + friendly name for a client IP (for the blocked-event JSON), so the
// dashboard can attribute a block to the right DEVICE (MAC/name) and not just the IP, which
// DHCP can reassign. Empty MAC when the IP isn't in the client/ARP table.
static String ipClientExtra(uint32_t ip) {
  String mac;
  for (int i = 0; i < numClients; i++)
    if (clients[i].ip == ip) {
      mac = macStr(clients[i].mac);
      break;
    }
  return ",\"mac\":\"" + mac + "\",\"name\":\"" + jesc(nameForIp(ip)) + "\"";
}
static void saveNames() {
  File f = LittleFS.open("/names.cfg", "w");
  if (!f) return;
  for (int i = 0; i < numNames; i++) {
    IPAddress ip(clientNames[i].ip);
    f.println(ip.toString() + " " + clientNames[i].name);
  }
  f.close();
}
static void loadNames() {
  numNames = 0;
  File f = LittleFS.open("/names.cfg", "r");
  if (!f) return;
  while (f.available() && numNames < MAX_NAMES) {
    String l = f.readStringUntil('\n');
    l.trim();
    if (!l.length()) continue;
    int sp = l.indexOf(' ');
    if (sp <= 0) continue;
    IPAddress ip;
    if (ip.fromString(l.substring(0, sp))) {
      clientNames[numNames].ip = (uint32_t)ip;
      clientNames[numNames].name = l.substring(sp + 1);
      clientNames[numNames].name.trim();
      numNames++;
    }
  }
  f.close();
}
static bool setClientName(const char* ips, String name) {
  IPAddress ip;
  if (!ip.fromString(ips)) return false;
  name.trim();
  if (name.length() > 31) name = name.substring(0, 31);
  for (int i = 0; i < numNames; i++)
    if (clientNames[i].ip == (uint32_t)ip) {
      if (name.length()) clientNames[i].name = name;
      else {
        for (int j = i; j < numNames - 1; j++) clientNames[j] = clientNames[j + 1];
        numNames--;
      }
      saveNames();
      return true;
    }
  if (!name.length() || numNames >= MAX_NAMES) return false;
  clientNames[numNames].ip = (uint32_t)ip;
  clientNames[numNames].name = name;
  numNames++;
  saveNames();
  return true;
}
static String jesc(const String& s) {
  String o;
  for (char ch : s) {
    if ((uint8_t)ch < 0x20) continue;
    if (ch == '"' || ch == '\\') o += '\\';
    o += ch;
  }
  return o;
}
// HTML escape for the block page: the Host header is attacker-controllable.
static String htmlEscape(const String& s) {
  String o;
  o.reserve(s.length());
  for (char ch : s) {
    switch (ch) {
    case '&':
      o += "&amp;";
      break;
    case '<':
      o += "&lt;";
      break;
    case '>':
      o += "&gt;";
      break;
    case '"':
      o += "&quot;";
      break;
    case '\'':
      o += "&#39;";
      break;
    default:
      o += ch;
    }
  }
  return o;
}

#include "page.h" // dashboard HTML (PROGMEM)

// Security headers applied to every HTML/JSON response (no TLS here, so no HSTS — it would
// be meaningless/ignored over plain HTTP). The dashboard inlines its icons and loads Alpine
// from unpkg (the browser caches it) and probes *.dnscheck (connect-src http:); the block page
// is inline-only. Alpine's CSP build interprets directives without eval — so no 'unsafe-eval'
// here. Keep this host in sync with the <script src> in web/index.html.
#define CSP_APP "default-src 'none'; script-src 'unsafe-inline' https://unpkg.com; style-src 'unsafe-inline'; img-src 'self' data: https://icons.duckduckgo.com; connect-src 'self' http:; base-uri 'none'; form-action 'self'; frame-ancestors 'none'"
#define CSP_BLOCK "default-src 'none'; style-src 'unsafe-inline'; script-src 'unsafe-inline'; img-src 'self' data:; connect-src 'self'; base-uri 'none'; form-action 'none'; frame-ancestors 'none'"
// 0 off · 1 basic (nosniff, X-Frame-Options, Referrer-Policy) · 2 standard (+Permissions-Policy,
// X-Robots-Tag, X-DNS-Prefetch-Control, X-Permitted-Cross-Domain-Policies, CSP) · 3 strict (+COOP/CORP).
static void secHeaders(const char* csp) {
  if (secLevel <= 0) return;
  web.sendHeader("X-Content-Type-Options", "nosniff");
  web.sendHeader("X-Frame-Options", "DENY");
  web.sendHeader("Referrer-Policy", "no-referrer"); // don't leak the URL/host out of our pages
  if (secLevel >= 2) {
    web.sendHeader("Permissions-Policy", "geolocation=(), camera=(), microphone=(), usb=()");
    web.sendHeader("X-Robots-Tag", "noindex, nofollow");
    web.sendHeader("X-DNS-Prefetch-Control", "off"); // privacy: no speculative DNS lookups
    web.sendHeader("X-Permitted-Cross-Domain-Policies", "none");
    if (csp) web.sendHeader("Content-Security-Policy", csp); // (no COEP require-corp: breaks CDN assets)
  }
  if (secLevel >= 3) {
    web.sendHeader("Cross-Origin-Opener-Policy", "same-origin");   // isolate against XS-Leak/Spectre
    web.sendHeader("Cross-Origin-Resource-Policy", "same-origin"); // reject cross-origin embedding
  }
}

// 401 with a human-readable body. The WWW-Authenticate header is what makes the browser
// prompt; this HTML is what remains if the prompt is dismissed (or the URL is opened by curl).
static void askAuth() {
  web.requestAuthentication(BASIC_AUTH, "esp-adblock",
                            "<!doctype html><meta charset=utf-8><title>Login required</title>"
                            "<body style=\"font:16px/1.5 system-ui,sans-serif;background:#0d1117;color:#e6edf3;max-width:34em;margin:12vh auto;padding:0 1.2em\">"
                            "<h1 style=\"font-size:19px\">Login required</h1>"
                            "<p>Your browser should have asked for a user name and password.</p>"
                            "<p>Both are in <code>config.env</code> (<code>WEB_USER</code>, <code>WEB_PASS</code>).</p>"
                            "<p>No prompt appeared? Reload this page.</p></body>");
}
static void handleStats() {
  if (!web.authenticate(WEB_USER, WEB_PASS)) {
    askAuth();
    return;
  }
  web.sendHeader("Cache-Control", "no-store");
  secHeaders(nullptr);
  uint32_t up = millis() / 1000;
  char ut[24];
  snprintf(ut, sizeof(ut), "%lud %luh %lum", (unsigned long)(up / 86400), (unsigned long)((up % 86400) / 3600), (unsigned long)((up % 3600) / 60));
  String j;
  j.reserve(4096); // clients[] + rules + events can exceed 1200; avoid realloc/fragmentation
  j = "{\"ip\":\"" + WiFi.localIP().toString() + "\",\"ver\":\"" + FW_VERSION + "\",\"upstream\":\"" + upstreamIP.toString() + "\",\"boot\":" + bootId +
      ",\"pl\":" + secLevel + ",\"ph\":" + secHdrCount(secLevel) + ",\"php\":" + secPages + ",\"psv\":" + pagesServed + ",\"pht\":" + SEC_HDR_TOTAL + ",\"doh\":" + dohHits + ",\"pac\":" + pacHits +
        ",\"gafam\":[" + gafamCnt[0] + "," + gafamCnt[1] + "," + gafamCnt[2] + "," + gafamCnt[3] + "," + gafamCnt[4] + "," + gafamCnt[5] + "]" +
        ",\"dnss\":[" + dnssecOk + "," + dnssecSeen + "]" + ",\"blocked\":" + totalBlocked + ",\"allowed\":" + totalAllowed + ",\"cached\":" + totalCached +
      ",\"domains\":" + numHashes + ",\"rssi\":" + WiFi.RSSI() + ",\"temp\":" + String(temperatureRead(), 1) +
      ",\"cpu\":" + ESP.getCpuFreqMHz() +
      ",\"dns\":" + (rttMs + locMs) + ",\"dnsf\":" + rttMs + ",\"dnsl\":" + locMs + ",\"dnsTo\":" + dnsTimeouts + ",\"vcc\":" + chipVcc() +
      ",\"dnslist\":[";
  for (int i = 0; i < dnsCount; i++) {
    j += (i ? "," : "");
    j += "{\"ip\":\"" + dnsList[i].toString() + "\",\"ms\":";
    j += (dnsRtt[i] == DNS_DEAD) ? String(-1) : String(dnsRtt[i]);
    j += ",\"cur\":" + String(i == dnsCur ? "true" : "false") + "}";
  }
  j += "],\"geo\":[";
  {
    bool first = true;
    for (uint16_t i = 0; i < GEO_NCODES; i++) {
      if (!geoHits[i]) continue;
      char cc[3];
      cc[0] = (char)pgm_read_byte(&GEO_CODES[i * 2]);
      cc[1] = (char)pgm_read_byte(&GEO_CODES[i * 2 + 1]);
      cc[2] = 0;
      j += (first ? "" : ",");
      first = false;
      j += "[\"" + String(cc) + "\"," + geoHits[i] + "]";
    }
  }
  j += "],\"geoMapped\":";
  j += geoMapped;
  j += ",\"pf\":" + String(dnsProbeFails) + ",\"dq\":" + stQueries + ",\"bc\":" + stBlkChecks + ",\"bch\":" + stBlkHits + ",\"bs\":" + stBloomSeeks + ",\"rc\":" + stRespCached +
       ",\"lg\":" + (stMaxGap / 1000) + ",\"lw\":" + (stMaxWeb / 1000) + ",\"ld\":" + (stMaxDns / 1000) +
       ",\"lt\":" + (stMaxTcp / 1000) +
       ",\"heap\":" + ESP.getFreeHeap() +
       ",\"hmin\":" + (stMinHeap == 0xFFFFFFFF ? 0 : stMinHeap) + ",\"hup\":" + (stMinHeapAt / 1000) +
       ",\"hctx\":" + stMinHeapCtx + ",\"uptime\":\"" + ut + "\"" +
       ",\"upat\":" + (lastUpdateMs ? (uint32_t)((millis() - lastUpdateMs) / 1000) : 0) +
       ",\"blocking\":" + (blockingOn ? "true" : "false") +
       ",\"resumeIn\":" + (uint32_t)(!blockingOn && resumeAt ? (resumeAt - millis()) / 1000 : 0) +
       ",\"defcreds\":" + (strcmp(WEB_PASS, "change-me-please") == 0 ? "true" : "false") +
       ",\"bmode\":" + blockMode + ",\"bttl\":" + blockTtl + ",\"v4only\":" + (ipv4Only ? "true" : "false") + ",\"kw\":" + (keywordBlock ? "true" : "false") + ",\"rb\":" + (rebindGuard ? "true" : "false") + ",\"ss\":" + safeSearchMask + ",\"ssid\":\"" + jesc(WiFi.SSID()) + "\",\"proxy\":\"" + jesc(proxyAddr) + "\"" +
       ",\"clients\":[";
  for (int i = 0; i < numClients; i++) {
    Dev& c = clients[i];
    if (macZero(c.mac)) getMac(c.ip, c.mac);   // pick up the ARP reply since requestMac()
    IPAddress ip(c.ip);
    j += (i ? "," : "");
    j += "{\"ip\":\"" + ip.toString() + "\",\"mac\":\"" + macStr(c.mac) + "\",\"name\":\"" + jesc(nameForIp(c.ip)) + "\",\"blocked\":" + c.blocked + ",\"allowed\":" + c.allowed + ",\"ps\":" + ((c.pausedUntil && (int32_t)(c.pausedUntil - millis()) > 0) ? (uint32_t)((c.pausedUntil - millis()) / 1000) : 0) + ",\"pac\":" + c.pac + "}";
  }
  j += "],\"custom\":[";
  for (int i = 0; i < numBlock; i++) {
    j += (i ? "," : "");
    j += "\"" + jesc(blockDom[i]) + "\"";
  }
  j += "],\"wild\":[";
  for (int i = 0; i < numWild; i++) {
    j += (i ? "," : "");
    j += "\"" + jesc(wildDom[i]) + "\"";
  }
  j += "],\"allow\":[";
  for (int i = 0; i < numAllow; i++) {
    j += (i ? "," : "");
    j += "\"" + jesc(allowDom[i]) + "\"";
  }
  j += "],\"keyword\":[";
  for (int i = 0; i < numKw; i++) {
    j += (i ? "," : "");
    j += "\"" + jesc(kwDom[i]) + "\"";
  }
  j += "],\"url\":[";
  for (int i = 0; i < numUrl; i++) {
    j += (i ? "," : "");
    j += "\"" + jesc(urlDom[i]) + "\"";
  }
  j += "],\"hosts\":[";
  {
    bool f2 = true;
    for (int i = 0; i < numHosts; i++) {
      IPAddress ip(localHosts[i].ip);
      j += (f2 ? "" : ",");
      f2 = false;
      j += "{\"n\":\"" + jesc(String(localHosts[i].name)) + "\",\"ip\":\"" + ip.toString() + "\"}";
    }
  }
  j += "],\"evSeq\":" + String(evSeq);
  bootDbgAddJson(j); // bt/nt/rst/prev.* only in a BOOT_DEBUG build
  j += "}";
  noteHeap(1); // peak of the biggest per-request allocation (this JSON): pre-OOM breadcrumb
  web.send(200, "application/json", j);
}
// Recent-blocked events since a cursor. The dashboard polls this (~2 s) and keeps the
// list client-side; the device only holds the small ring, no history.
static void handleEvents() {
  if (!web.authenticate(WEB_USER, WEB_PASS)) {
    askAuth();
    return;
  }
  web.sendHeader("Cache-Control", "no-store");
  secHeaders(nullptr);
  uint32_t since = web.hasArg("since") ? (uint32_t)web.arg("since").toInt() : 0;
  uint32_t oldest = (evSeq > EV_N) ? (evSeq - EV_N + 1) : 1;
  uint32_t from = since + 1, skipped = 0;
  if (from < oldest) { // the client fell behind the ring: say how much was lost, resume at oldest
    skipped = oldest - from;
    from = oldest;
  }
  String j;
  j.reserve(64 + EV_N * 128); // bounded: one page of at most EV_N events, no realloc
  j += "{\"last\":";
  j += skipped ? from - 1 : since;
  j += ",\"ev\":[";
  bool first = true;
  uint32_t last = skipped ? from - 1 : since;
  int n = 0;
  for (uint32_t s = from; s <= evSeq && n < EV_N; s++) {
    BlockEv& e = evRing[s % EV_N];
    if (e.seq != s) continue;
    j += (first ? "" : ",");
    first = false;
    j += "{\"seq\":" + String(e.seq) + ",\"n\":" + String(e.count) + ",\"host\":\"" + jesc(String(e.host)) + "\",\"cip\":\"" + IPAddress(e.cip).toString() + "\"" + ipClientExtra(e.cip) + ",\"gaf\":" + gafamOf(e.host) + "}";
    last = s;
    n++;
  }
  j += "],\"more\":";
  j += (last < evSeq ? "true" : "false");
  if (skipped) {
    j += ",\"skipped\":";
    j += String(skipped);
  }
  j += "}";
  noteHeap(1);
  web.send(200, "application/json", j);
}
static const char* CSRF_HEADER = "X-Requested-With";
static const char* CSRF_VALUE = "esp-adblock";
static bool requireAuth() {
  if (web.header(CSRF_HEADER) != CSRF_VALUE) {
    web.send(403, "text/plain", "missing CSRF header");
    return false;
  }
  if (web.authenticate(WEB_USER, WEB_PASS)) return true;
  askAuth();
  return false;
}

// ---------- block page (captive "why is this blocked" + allow) ----------
// Blocked A records resolve to the ESP, so an HTTP client lands here. The button adds
// the domain to the runtime allowlist (no Basic auth — the end user has no credentials;
// it is CSRF-gated like the other state endpoints).
static void handleAllow() {
  if (web.header(CSRF_HEADER) != CSRF_VALUE) {
    web.send(403, "text/plain", "missing CSRF header");
    return;
  }
  String d = web.arg("d");
  long s = web.hasArg("s") ? web.arg("s").toInt() : 0; // s = seconds → temporary allow
  if (s > 0) {
    if (s > 86400) s = 86400;
    addTempAllow(d, (uint32_t)s * 1000UL);
  } // cap 24 h
  else
    addAllow(d); // no s → permanent
  web.send(200, "text/plain", "ok");
}
// PAC: served as-is; the OS/browser runs FindProxyForURL. Local names stay DIRECT.
static void handlePac() {
  web.sendHeader("Cache-Control", "no-store");
  String bh = WiFi.localIP().toString() + ":" + String(BLACKHOLE_PORT);
  String b = "function FindProxyForURL(url, host){";
  // "url <substr>" rules: the client's PAC sees the full URL (path included) and routes a
  // match to this device's black-hole port, which just drops it -> that resource fails to
  // load. This device never proxies real traffic; it only closes these connections.
  // While blocking is paused (globally or for this client) emit no url rules, so a fresh
  // PAC fetch stops routing matched URLs to the black hole.
  if (blockingActiveFor((uint32_t)web.client().remoteIP()))
    for (int i = 0; i < numUrl; i++)
      b += "if(url.indexOf('" + urlDom[i] + "')>=0)return 'PROXY " + bh + ";';";
  b += "if(isPlainHostName(host)||shExpMatch(host,'*.local')||host=='localhost'||shExpMatch(host,'127.*')||shExpMatch(host,'192.168.*')||shExpMatch(host,'10.*'))return 'DIRECT';";
  b += proxyAddr.length() ? ("return 'PROXY " + proxyAddr + "; DIRECT';}") : "return 'DIRECT';}";
  web.send(200, "application/x-ns-proxy-autoconfig", b);
}
// DoH (RFC 8484) WITHOUT TLS, on the plain HTTP server: GET /dns-query?dns=<base64url> or
// POST /dns-query (application/dns-message). Lets a cooperating client app use this device
// as its resolver over DoH-in-the-clear — no certificate. OS-native DoH still can't (it
// demands HTTPS); plain DNS :53 stays the universal path.
static int b64urlDecode(const String& s, uint8_t* out, int outSz) {
  int o = 0, val = 0, bits = 0;
  for (size_t i = 0; i < s.length(); i++) {
    char c = s[i];
    int d;
    if (c >= 'A' && c <= 'Z') d = c - 'A';
    else if (c >= 'a' && c <= 'z') d = c - 'a' + 26;
    else if (c >= '0' && c <= '9') d = c - '0' + 52;
    else if (c == '-' || c == '+') d = 62;
    else if (c == '_' || c == '/') d = 63;
    else if (c == '=') break;
    else continue; // skip whitespace
    val = (val << 6) | d;
    bits += 6;
    if (bits >= 8) {
      bits -= 8;
      if (o < outSz) out[o++] = (uint8_t)(val >> bits);
    }
  }
  return o;
}
// Blocking single-shot upstream query (DoH is rare, so a synchronous wait is fine).
static int dohForward(int qlen) {
  WiFiUDP u;
  if (!u.begin(0)) return 0;
  uint16_t id = (uint16_t)rnd32();
  buf[0] = id >> 8;
  buf[1] = id & 0xFF;
  u.beginPacket(upstreamIP, UPSTREAM_PORT);
  u.write(buf, qlen);
  u.endPacket();
  uint32_t t0 = millis();
  int n = 0;
  while ((uint32_t)(millis() - t0) < 2000) {
    int sz = u.parsePacket();
    if (sz <= 0) continue;
    if (sz > (int)sizeof(buf)) { // don't relay a truncated reply
      udpDrop(u);
      continue;
    }
    n = u.read(buf, sizeof(buf));
    if (n >= 12 && (((buf[0] << 8) | buf[1]) == id)) break;
    n = 0;
  }
  u.stop();
  return n;
}
static void handleDoh() {
  int qlen = 0;
  if (web.method() == HTTP_GET) {
    qlen = b64urlDecode(web.arg("dns"), buf, sizeof(buf));
  } else {
    String b = web.arg("plain");
    qlen = b.length();
    if (qlen < 12 || qlen > (int)sizeof(buf)) qlen = 0;
    else memcpy(buf, b.c_str(), qlen);
  }
  if (qlen < 12) {
    web.send(400, "text/plain", "bad dns query");
    return;
  }
  char domain[256];
  uint16_t qtype = 0;
  int qend = qlen;
  size_t dl = parseQuery(buf, qlen, domain, &qtype, &qend);
  uint32_t cip = (uint32_t)web.client().remoteIP();
  int rlen = localAnswer(getClient(cip), cip, domain, dl, qtype, qend); // block/local/safesearch
  if (rlen == 0) {
    uint16_t oid = (buf[0] << 8) | buf[1];
    rlen = dohForward(qlen);
    if (rlen > 0) {
      buf[0] = oid >> 8;
      buf[1] = oid & 0xFF; // DoH reply must echo the request txid
      char cn[256];
      if (blockingActiveFor(cip) && cnameBlocked(buf, rlen, qend, cn, sizeof(cn))) { // same defenses as the UDP path
        buf[2] = 0x81;
        buf[3] = 0x83;
        buf[6] = buf[7] = buf[8] = buf[9] = buf[10] = buf[11] = 0;
        rlen = qend;
      } else {
        clampTTL(buf, rlen, qend, TTL_CLAMP_S);
      }
    }
  }
  if (rlen <= 0) {
    web.send(504, "text/plain", "upstream timeout");
    return;
  }
  web.sendHeader("Cache-Control", "no-store");
  secHeaders(nullptr);
  String out; // String(const char*, len) isn't available on ESP8266; append bytes (keeps NULs)
  out.reserve(rlen);
  for (int i = 0; i < rlen; i++) out += (char)buf[i];
  noteHeap(1); // DoH copies the reply into a String: another per-request heap peak
  web.send(200, "application/dns-message", out);
}
static void handleSetProxy() {
  if (!requireAuth()) return;
  if (web.hasArg("p")) {
    String p = web.arg("p");
    p.trim();
    if (p.length()) { // must be host:port — it is interpolated into the PAC JavaScript
      int colon = p.lastIndexOf(':');
      bool bad = colon <= 0 || colon == (int)p.length() - 1 || p.length() > 64 ||
                 p.substring(colon + 1).toInt() <= 0;
      for (size_t i = 0; !bad && i < p.length(); i++)
        if (!isalnum((unsigned char)p[i]) && p[i] != '.' && p[i] != '-' && p[i] != ':' && p[i] != '_') bad = true;
      if (bad) {
        web.send(400, "text/plain", "bad proxy: need host:port");
        return;
      }
    }
    proxyAddr = p;
  }
  saveProxyCfg();
  web.send(200, "text/plain", "ok");
}
// Settings endpoints (auth+CSRF via requireAuth).
static void handleSetBlock() {
  if (!requireAuth()) return;
  if (web.hasArg("m")) {
    String m = web.arg("m");
    m.toLowerCase();
    blockMode = (m == "zero") ? BLOCK_MODE_ZERO : (m == "nxdomain") ? BLOCK_MODE_NX
                                                                    : BLOCK_MODE_IP;
  }
  if (web.hasArg("v4")) ipv4Only = (web.arg("v4") == "1");
  if (web.hasArg("kw")) keywordBlock = (web.arg("kw") == "1");
  if (web.hasArg("rb")) rebindGuard = (web.arg("rb") == "1");
  if (web.hasArg("ss")) safeSearchMask = (uint8_t)(web.arg("ss").toInt() & 0xF);
  if (web.hasArg("pl")) secLevel = (uint8_t)constrain(web.arg("pl").toInt(), 0, 3);
  if (web.hasArg("ttl")) blockTtl = (uint32_t)constrain(web.arg("ttl").toInt(), 0, 86400);
  saveBlockCfg();
  web.send(200, "text/plain", "ok");
}
static void handleSetHost() {
  if (!requireAuth()) return;
  web.send(200, "text/plain", setHost(web.arg("n"), web.arg("ip")) ? "ok" : "bad name/ip or table full");
}
static void handleDelHost() {
  if (!requireAuth()) return;
  delHost(web.arg("n"));
  web.send(200, "text/plain", "ok");
}
static void handleBlockPage() {
  web.sendHeader("Cache-Control", "no-store");
  secHeaders(CSP_BLOCK);
  String host = web.hostHeader();
  int colon = host.indexOf(':');
  if (colon > 0) host = host.substring(0, colon);
  const bool custom = isBlockDomain(host.c_str()) || isWildBlock(host.c_str());
  pagesServed++;                // every HTML page served (denominator for the % protected)
  if (secLevel > 0) secPages++; // this block page got the privacy rewrite
  String html(BLOCK_TMPL); // PROGMEM template -> SRAM
  html.replace("{{HOST}}", htmlEscape(host));
  html.replace("{{REASON}}", custom ? "custom block rule" : "ad / tracker / malware list");
  html.replace("{{ESP}}", WiFi.localIP().toString());
  web.setContentLength(CONTENT_LENGTH_UNKNOWN); // chunked (see handleRoot)
  web.send(200, "text/html; charset=utf-8", "");
  web.sendContent(html);
  web.sendContent("");
}
// Fires for any path not explicitly routed. If the Host isn't this device, the client
// was pointed here by a sinkholed A record: show the block page (or, once allowed, a note).
// The device answers to its own IP, to any "<name>.local", to WIFI_HOST (cfgHost, from
// /wifi.cfg or secrets.h) and to any /hosts.cfg entry that points back at it. Anything else
// was pointed here by a sinkholed A record -> block page.
static bool isDeviceName(const String& h) {
  if (h == WiFi.localIP().toString() || h.endsWith(".local")) return true;
  const char* self = cfgHost.length() ? cfgHost.c_str() : WIFI_HOST;
  if (self && *self && h.equalsIgnoreCase(self)) return true;
  for (int i = 0; i < numHosts; i++)
    if (h.equalsIgnoreCase(localHosts[i].name) && localHosts[i].ip == (uint32_t)WiFi.localIP()) return true;
  return false;
}
static bool foreignHost(String& host) {
  host = web.hostHeader();
  int colon = host.indexOf(':');
  if (colon > 0) host = host.substring(0, colon);
  host.toLowerCase();
  return host.length() && !isDeviceName(host);
}
static void serveSinkhole(const String& host) {
  const bool active = blockingActiveFor((uint32_t)web.client().remoteIP());
  if (active && isBlocked(host.c_str())) {
    handleBlockPage();
    return;
  }
  web.sendHeader("Cache-Control", "no-store");
  secHeaders(nullptr);
  web.send(200, "text/html; charset=utf-8", active ? "<!doctype html><meta charset=utf-8><body style='font:16px system-ui;text-align:center;margin-top:60px'>"
                                                     "Allowed. Reload in a few seconds (DNS cache).</body>"
                                                   : "<!doctype html><meta charset=utf-8><body style='font:16px system-ui;text-align:center;margin-top:60px'>"
                                                     "Blocking is paused. Reload in a few seconds (DNS cache).</body>");
}
// Root: the dashboard for this device, the block page for a sinkholed host.
// The dashboard requires Basic auth: navigation makes the browser prompt for WEB_PASS,
// and the browser then attaches the cached credentials to the page's own fetch() calls
// (a fetch()/XHR 401 does NOT show the prompt itself, so the page must demand it).
static void handleRoot() {
  String host;
  if (foreignHost(host)) {
    serveSinkhole(host);
    return;
  }
  if (!web.authenticate(WEB_USER, WEB_PASS)) {
    askAuth();
    return;
  }
  // Revalidate every load (ETag -> 304, tiny): a dashboard that changes on reflash must not be
  // pinned in the browser for an hour. No body is re-sent unless the page actually changed.
  char etag[24];
  snprintf(etag, sizeof(etag), "\"%u\"", (unsigned)(sizeof(PAGE) - 1));
  web.sendHeader("ETag", etag);
  web.sendHeader("Cache-Control", "no-cache");
  secHeaders(CSP_APP);
  if (web.header("If-None-Match") == etag) {
    web.send(304, "text/plain", ""); // not modified: no body -> don't count a page
    return;
  }
  pagesServed++;                // every HTML page served (denominator for the % protected)
  if (secLevel > 0) secPages++; // this dashboard body got the privacy rewrite
  // Chunked (no fixed Content-Length): a declared length can mismatch the body if the send
  // is cut mid-way (big page + busy radio) -> "net::ERR_CONTENT_LENGTH_MISMATCH" on the client.
  web.setContentLength(CONTENT_LENGTH_UNKNOWN);
  web.send(200, "text/html; charset=utf-8", "");
  web.sendContent_P(PAGE);
  web.sendContent(""); // end the chunked body
}
// World map for the destination card. Static and public-domain (Natural Earth), so it is
// served as a separate cached asset instead of inflating every dashboard response.
static void handleWorldSvg() {
  if (!web.authenticate(WEB_USER, WEB_PASS)) {
    askAuth();
    return;
  }
  char etag[24];
  snprintf(etag, sizeof(etag), "\"w%u\"", (unsigned)(sizeof(WORLD_SVG) - 1));
  web.sendHeader("ETag", etag);
  web.sendHeader("Cache-Control", "public, max-age=86400");
  web.sendHeader("X-Content-Type-Options", "nosniff");
  if (web.header("If-None-Match") == etag) {
    web.send(304, "text/plain", "");
    return;
  }
  web.setContentLength(CONTENT_LENGTH_UNKNOWN);
  web.send(200, "image/svg+xml", "");
  web.sendContent_P(WORLD_SVG);
  web.sendContent("");
}
static void handleNotFound() {
  String host;
  if (foreignHost(host)) {
    serveSinkhole(host);
    return;
  }
  web.send(404, "text/plain", "not found");}

// ---------- blocklist swap (shared by upload + remote fetch) ----------
static uint32_t le32(const uint8_t* p) { return (uint32_t)p[0] | ((uint32_t)p[1] << 8) | ((uint32_t)p[2] << 16) | ((uint32_t)p[3] << 24); }
// Read the 'RGX1' section at `off`: u16 count, then (u16 len + pattern)*. Records longer
// than RGX_MAXLEN are skipped (past the count cap). Partial section -> keep what loaded.
static uint32_t loadRegexSection(uint32_t off) { // returns the offset just past 'RGX1'
  numRgx = 0;
  if (!blocklist.seek(off)) return off;
  uint8_t m[4];
  if (blocklist.read(m, 4) != 4 || m[0] != 'R' || m[1] != 'G' || m[2] != 'X' || m[3] != '1') return off;
  uint8_t cb[2];
  if (blocklist.read(cb, 2) != 2) return off;
  uint16_t count = (uint16_t)(cb[0] | (cb[1] << 8));
  for (uint16_t i = 0; i < count; i++) {
    uint8_t lb[2];
    if (blocklist.read(lb, 2) != 2) break;
    uint16_t len = (uint16_t)(lb[0] | (lb[1] << 8));
    if (len == 0 || len >= RGX_MAXLEN || numRgx >= MAX_RGX) { blocklist.seek(blocklist.position() + len); continue; }
    if (blocklist.read((uint8_t*)rgxPat[numRgx], len) != len) break;
    rgxPat[numRgx][len] = 0;
    numRgx++;
  }
  return (uint32_t)blocklist.position();
}
// 'GAFM' | 5 x (u16 bytes + bitmap): provider Blooms (G/A/F/Amazon/Microsoft) for telemetry.
static void loadGafamSection(uint32_t off) {
  gafamOk = false;
  for (int i = 0; i < 5; i++) { gafamOff[i] = 0; gafamLen[i] = 0; }
  if (!blocklist.seek(off)) return;
  uint8_t m[4];
  if (blocklist.read(m, 4) != 4 || m[0] != 'G' || m[1] != 'A' || m[2] != 'F' || m[3] != 'M') return;
  uint16_t pos = 0;
  for (int i = 0; i < 5; i++) {
    uint8_t lb[2];
    if (blocklist.read(lb, 2) != 2) return;
    uint16_t len = (uint16_t)(lb[0] | (lb[1] << 8));
    if (len == 0 || (int)pos + len > (int)sizeof(gafamBuf)) return;
    if (blocklist.read(gafamBuf + pos, len) != len) return;
    gafamOff[i] = pos;
    gafamLen[i] = len;
    pos += len;
  }
  gafamOk = true;
}
static void reopenBlocklist() {
  blocklist = LittleFS.open(BLOCKLIST_PATH, "r");
  if (!blocklist) blocklist = LittleFS.open("/blocklist.old", "r"); // interrupted swap
  numHashes = 0;
  bloomM = 0;
  numRgx = 0;
  bloomBase = BLOCKLIST_HDR;
  if (blocklist) {
    uint8_t hdr[BLOCKLIST_HDR];
    if (blocklist.read(hdr, BLOCKLIST_HDR) == BLOCKLIST_HDR && hdr[0] == 'B' && hdr[1] == 'L' && hdr[2] == 'M') {
      numHashes = le32(hdr + 4);
      if (hdr[3] == '1') {
        bloomM = (uint32_t)((blocklist.size() - BLOCKLIST_HDR) * 8);
      } else if (hdr[3] == '2') {
        uint8_t mb[4];
        size_t fsz = blocklist.size();
        if (blocklist.read(mb, 4) == 4) {
          uint32_t bitmapBytes = le32(mb);
          bloomBase = BLOCKLIST_HDR + 4;
          // The declared bitmap must lie inside the file. A bogus/huge value would make
          // bloomBit() read past EOF (fail-open: blocking silently off) and wrap the RGX1
          // offset (random bytes parsed as regexes). Reject the whole blob instead.
          if (bitmapBytes > 0 && (uint64_t)bloomBase + bitmapBytes <= fsz) {
            bloomM = bitmapBytes * 8;
            loadGafamSection(loadRegexSection(bloomBase + bitmapBytes)); // 'RGX1' then 'GAFM'
          } else {
            Serial.printf("[bloom] BLM2 bitmap out of range (%u bytes, file %u) — blocklist ignored\n",
                          (unsigned)bitmapBytes, (unsigned)fsz);
            numHashes = 0;
            bloomM = 0;
          }
        } else {
          bloomM = 0;
        }
      } else {
        Serial.println("[bloom] bad header — blocklist ignored");
      }
    } else {
      Serial.println("[bloom] bad header — blocklist ignored");
    }
  }
  buildFlashIndex();
}
// Free bytes on the blocklist filesystem (the cores expose this differently).
static size_t fsFreeBytes() {
#if defined(ESP8266)
  FSInfo inf;
  if (!LittleFS.info(inf) || inf.totalBytes < inf.usedBytes) return 0;
  return inf.totalBytes - inf.usedBytes;
#else
  size_t total = LittleFS.totalBytes(), used = LittleFS.usedBytes();
  return total > used ? total - used : 0;
#endif
}
static void beginBlocklistSwap(size_t incoming) {
  // Clear the pending file. When the filesystem can hold both blobs (ESP8266's 2 MB FS) the
  // live list keeps serving until commitNewBlocklist() validates and swaps in the new one.
  LittleFS.remove("/blocklist.new");
  File live = LittleFS.open(BLOCKLIST_PATH, "r");
  size_t liveB = live ? live.size() : 0;
  if (live) live.close();
  size_t freeB = fsFreeBytes();
  // The ESP32 layout has a 0.96 MB blocklist partition but a ~930 KB blob: a second copy
  // never fits, so the safe swap would reject every upload. Free the live copy first (the
  // upload then streams into /blocklist.new); on an aborted upload blocking fails open.
  if (liveB && incoming && freeB < incoming + 512) {
    if (blocklist) blocklist.close();
    LittleFS.remove("/blocklist.old");
    if (LittleFS.remove(BLOCKLIST_PATH)) {
      Serial.printf("[ota] FS free %u B < upload %u B: live blocklist dropped for the swap\n",
                    (unsigned)freeB, (unsigned)incoming);
      reopenBlocklist(); // numHashes=0 while /blocklist.new is written
    }
  }
}
static bool commitNewBlocklist() { // /blocklist.new -> live (validated)
  File f = LittleFS.open("/blocklist.new", "r");
  size_t sz = f ? f.size() : 0;
  bool ok = false;
  if (f && sz > BLOCKLIST_HDR) { // validate the magic and, for BLM2, the declared bitmap size
    uint8_t hdr[BLOCKLIST_HDR];
    ok = f.read(hdr, BLOCKLIST_HDR) == BLOCKLIST_HDR && hdr[0] == 'B' && hdr[1] == 'L' && hdr[2] == 'M' && (hdr[3] == '1' || hdr[3] == '2');
    if (ok && hdr[3] == '2') { // BLM2: the bitmap must fit, else the device would fail open
      uint8_t mb[4];
      ok = f.read(mb, 4) == 4 && le32(mb) > 0 && (uint64_t)(BLOCKLIST_HDR + 4) + le32(mb) <= sz;
    }
  }
  if (f) f.close();
  if (ok) { // swap: keep a recoverable copy until the new file is live
    if (blocklist) blocklist.close();
    LittleFS.remove("/blocklist.old");
    LittleFS.rename(BLOCKLIST_PATH, "/blocklist.old");
    LittleFS.rename("/blocklist.new", BLOCKLIST_PATH);
    LittleFS.remove("/blocklist.old");
    lastUpdateMs = millis(); // also counts a browser upload as "updated"
  } else {
    LittleFS.remove("/blocklist.new"); // bad/empty download -> keep the live list
  }
  reopenBlocklist();
  return ok;
}

// ---------- OTA blocklist update (browser upload) ----------
static bool upOk = false;
static bool upWriteOk = false; // every chunk reached the filesystem
static bool upAuthOk = false;
static File upFile;
static void handleUploadDone() {
  if (!upAuthOk) {
    askAuth();
    return;
  }
  web.send(upOk ? 200 : 500, "text/plain",
           upOk ? "ok" : "rejected: not a BLM1/BLM2 blocklist.bin");
}
static void handleUpload() {
  HTTPUpload& u = web.upload();
  switch (u.status) {
  case UPLOAD_FILE_START:
    upAuthOk = web.header(CSRF_HEADER) == CSRF_VALUE && web.authenticate(WEB_USER, WEB_PASS);
    if (!upAuthOk) {
      Serial.println("[ota] blocklist upload: auth/CSRF check failed");
      break;
    }
    upOk = false;
    beginBlocklistSwap((size_t)web.header("Content-Length").toInt()); // 0 if chunked
    upFile = LittleFS.open("/blocklist.new", "w");
    upWriteOk = (bool)upFile; // a full/failed FS must reject the blob, not silently truncate it
    Serial.printf("[ota] receiving %s\n", u.filename.c_str());
    break;
  case UPLOAD_FILE_WRITE:
    if (upAuthOk && upFile && upFile.write(u.buf, u.currentSize) != u.currentSize) upWriteOk = false;
    break;
  case UPLOAD_FILE_END:
    if (!upAuthOk) break;
    if (upFile) upFile.close();
    upOk = upWriteOk && commitNewBlocklist();
    if (!upWriteOk) { // never hand a truncated blob to the validator
      LittleFS.remove("/blocklist.new");
      if (blocklist) blocklist.close();
      reopenBlocklist();
    }
    Serial.printf("[ota] %s -> %u domains\n", upOk ? "OK" : "REJECTED", (unsigned)numHashes);
    break;
  case UPLOAD_FILE_ABORTED:
    if (!upAuthOk) break;
    if (upFile) upFile.close();
    LittleFS.remove("/blocklist.new");
    reopenBlocklist();
    Serial.println("[ota] aborted");
    break;
  }
}

// ---------- persisted counters (/stats.cfg) + reset ----------
static uint32_t savedBlocked = 0, savedAllowed = 0, savedCached = 0; // last persisted snapshot
static uint32_t savedGafam = 0, savedDnssec = 0, savedSecPages = 0, savedPagesServed = 0; // ...GAFM/DNSSEC/pages
static void loadStats() {
  File f = LittleFS.open("/stats.cfg", "r");
  if (!f) return;
  totalBlocked = f.readStringUntil('\n').toInt();
  totalAllowed = f.readStringUntil('\n').toInt();
  totalCached = f.readStringUntil('\n').toInt();
  for (int i = 0; i < 6 && f.available(); i++) gafamCnt[i] = (uint32_t)f.readStringUntil('\n').toInt();
  if (f.available()) dnssecOk = (uint32_t)f.readStringUntil('\n').toInt();
  if (f.available()) dnssecSeen = (uint32_t)f.readStringUntil('\n').toInt();
  if (f.available()) secPages = (uint32_t)f.readStringUntil('\n').toInt();
  if (f.available()) pagesServed = (uint32_t)f.readStringUntil('\n').toInt();
  if (pagesServed < secPages) pagesServed = secPages; // migration/consistency: denom >= numer
  // Destination map: sparse "CC count" lines, one per country that got traffic (old files: none).
  while (f.available()) {
    String ln = f.readStringUntil('\n');
    if (ln.length() < 4 || ln[2] != ' ') continue;
    for (uint16_t i = 0; i < GEO_NCODES; i++)
      if (ln[0] == (char)pgm_read_byte(&GEO_CODES[i * 2]) &&
          ln[1] == (char)pgm_read_byte(&GEO_CODES[i * 2 + 1])) {
        uint32_t v = (uint32_t)ln.substring(3).toInt();
        geoHits[i] += v;
        geoMapped += v;
        break;
      }
  }
  f.close();
  savedBlocked = totalBlocked;
  savedAllowed = totalAllowed;
  savedCached = totalCached;
  savedGafam = gafamCnt[0] + gafamCnt[1] + gafamCnt[2] + gafamCnt[3] + gafamCnt[4] + gafamCnt[5];
  savedDnssec = dnssecSeen;
  savedSecPages = secPages;
  savedPagesServed = pagesServed;
}
static void saveStats() {
  File f = LittleFS.open("/stats.cfg", "w");
  if (!f) return;
  f.println(totalBlocked);
  f.println(totalAllowed);
  f.println(totalCached);
  for (int i = 0; i < 6; i++) f.println(gafamCnt[i]); // provider share of allowed lookups
  f.println(dnssecOk);
  f.println(dnssecSeen);
  f.println(secPages);    // pages that got the privacy (header) rewrite
  f.println(pagesServed); // all pages served (so the % survives reboots)
  // Destination map: only the countries that were hit (245 slots, ~40 lines typical).
  for (uint16_t i = 0; i < GEO_NCODES; i++)
    if (geoHits[i])
      f.printf("%c%c %u\n", (char)pgm_read_byte(&GEO_CODES[i * 2]),
               (char)pgm_read_byte(&GEO_CODES[i * 2 + 1]), (unsigned)geoHits[i]);
  f.close();
  savedBlocked = totalBlocked;
  savedAllowed = totalAllowed;
  savedCached = totalCached;
  savedGafam = gafamCnt[0] + gafamCnt[1] + gafamCnt[2] + gafamCnt[3] + gafamCnt[4] + gafamCnt[5];
  savedDnssec = dnssecSeen;
  savedSecPages = secPages;
  savedPagesServed = pagesServed;
}
static void resetStats() {
  totalBlocked = totalAllowed = totalCached = 0;
  dohHits = 0;
  pacHits = 0;
  for (int i = 0; i < numClients; i++) {
    clients[i].blocked = 0;
    clients[i].allowed = 0;
    clients[i].pac = 0;
  }
  for (int i = 0; i < 6; i++) gafamCnt[i] = 0;
  for (uint16_t i = 0; i < GEO_NCODES; i++) geoHits[i] = 0;
  geoMapped = 0;
  dnssecOk = dnssecSeen = 0;
  secPages = 0;
  pagesServed = 0;
  evSeq = 0;           // clear the recent-blocked ring too
  statsSaveReq.mark(); // flush from the loop, not inside the HTTP handler
}
// ---------- firmware OTA (browser upload of firmware.bin -> reboot) ----------
static bool fwAuthOk = false;
static void handleFwUpdateDone() {
  if (!fwAuthOk) {
    askAuth();
    return;
  }
  bool ok = !Update.hasError();
  web.send(ok ? 200 : 500, "text/plain", ok ? "ok, rebooting" : "firmware update failed");
  if (ok) {
    bootDbgMarkRestart(BOOT_INTENT_OTA); // tell the next boot this reset was ours, not a crash
    delay(300);
    ESP.restart();
  }
}
static void handleFwUpload() {
  HTTPUpload& u = web.upload();
  if (u.status == UPLOAD_FILE_START) {
    fwAuthOk = web.header(CSRF_HEADER) == CSRF_VALUE && web.authenticate(WEB_USER, WEB_PASS);
    if (!fwAuthOk) {
      Serial.println("[fw-ota] auth/CSRF check failed, rejecting flash");
      return;
    }
    Serial.printf("[fw-ota] %s\n", u.filename.c_str());
#if defined(ESP8266)
    if (!Update.begin((ESP.getFreeSketchSpace() - 0x1000) & 0xFFFFF000)) Update.printError(Serial);
#else
    if (!Update.begin(UPDATE_SIZE_UNKNOWN)) Update.printError(Serial);
#endif
  } else if (u.status == UPLOAD_FILE_WRITE) {
    if (!fwAuthOk) return;
    if (Update.write(u.buf, u.currentSize) != u.currentSize) Update.printError(Serial);
  } else if (u.status == UPLOAD_FILE_END) {
    if (!fwAuthOk) return;
    if (Update.end(true)) Serial.printf("[fw-ota] %u bytes OK\n", u.totalSize);
    else Update.printError(Serial);
  } else if (u.status == UPLOAD_FILE_ABORTED) {
    if (!fwAuthOk) return;
#if defined(ESP8266)
    Serial.println("[fw-ota] aborted"); // ESP8266 Updater has no abort(); next begin() resets it
#else
    Update.abort();
    Serial.println("[fw-ota] aborted");
#endif
  }
}

#if !defined(ESP8266)
// ESP32 bootloader already runs with CONFIG_BOOTLOADER_APP_ROLLBACK_ENABLE. The core's
// default verifyRollbackLater()==false would confirm the new image at boot, before setup()
// can prove anything; return true so the image stays pending until we confirm it.
extern "C" bool verifyRollbackLater() { return true; }

// Confirm a freshly flashed image only after 60 s of uptime: a panic/boot loop rolls
// back automatically (on the next reset), a healthy boot keeps it. No extra partition.
static bool otaConfirmed = false;
static void confirmOtaIfSettled() {
  if (otaConfirmed || millis() < 60000UL) return;
  otaConfirmed = true;
  if (esp_ota_mark_app_valid_cancel_rollback() == ESP_OK)
    Serial.println("[ota] image confirmed valid");
}
#endif

// ---------- WiFi provisioning (SmartConfig / ESP-Touch) ----------
// /wifi.cfg is baked into the LittleFS image by tools/gen_config.py. It takes priority
// over NVS/secrets.h, so re-uploading the filesystem re-provisions without recompiling.
// Format: KEY=VALUE lines (WIFI_SSID, WIFI_PASS, ...).
static bool loadCfgFile(String& ssid, String& pass) {
  File f = LittleFS.open("/wifi.cfg", "r");
  if (!f) return false;
  while (f.available()) {
    String l = f.readStringUntil('\n');
    l.trim();
    if (!l.length() || l.startsWith("#")) continue;
    int eq = l.indexOf('=');
    if (eq < 0) continue;
    String k = l.substring(0, eq);
    k.trim();
    k.toUpperCase();
    String v = l.substring(eq + 1);
    v.trim();
    if (k == "WIFI_SSID") ssid = v;
    else if (k == "WIFI_PASS") pass = v;
    else if (k == "WIFI_IP") cfgIp = v;
    else if (k == "WIFI_GW") cfgGw = v;
    else if (k == "WIFI_DNS") cfgDns = v;
    else if (k == "WIFI_HOST") cfgHost = v;
  }
  f.close();
  return ssid.length() > 0;
}
static bool hasCreds() {
  String a, b;
  if (loadCfgFile(a, b)) return true;
  prefs.begin("wifi", true);
  bool nvs = prefs.getString("ssid", "").length() > 0;
  prefs.end();
  return nvs || (WIFI_SSID && *WIFI_SSID && strcmp(WIFI_SSID, "YOUR_WIFI_SSID") != 0);
}
static bool connectWiFi() {
  String ss, pw;
  const bool fromCfg = loadCfgFile(ss, pw); // /wifi.cfg (baked) wins
  if (!fromCfg) {
    prefs.begin("wifi", true);
    ss = prefs.getString("ssid", "");
    pw = prefs.getString("pass", "");
    prefs.end();
  }
  const char* ssid = ss.length() ? ss.c_str() : WIFI_SSID;
  const char* pass = ss.length() ? pw.c_str() : WIFI_PASS;
  if (!ssid || !*ssid || strcmp(ssid, "YOUR_WIFI_SSID") == 0) return false; // unconfigured
  Serial.printf("WiFi: connecting to \"%s\"%s\n", ssid,
                fromCfg ? " (/wifi.cfg)" : (ss.length() ? " (provisioned)" : " (secrets.h)"));
  WiFi.mode(WIFI_STA);
#if defined(ESP8266)
  WiFi.setSleepMode(WIFI_NONE_SLEEP);
  WiFi.setOutputPower(20.5f); // max TX power (weak-signal links)
#else
  WiFi.setSleep(false);
  WiFi.setTxPower(WIFI_POWER_19_5dBm);
#endif
  // Hostname (so the router's DHCP list and mDNS show 'esp-adblock').
  const char* host = cfgHost.length() ? cfgHost.c_str() : WIFI_HOST;
  if (host && *host) {
#if defined(ESP8266)
    WiFi.hostname(host);
#else
    WiFi.setHostname(host);
#endif
  }
  // Optional static IP (empty -> DHCP).
  const char* ipc = cfgIp.length() ? cfgIp.c_str() : WIFI_IP;
  const char* gwc = cfgGw.length() ? cfgGw.c_str() : WIFI_GW;
  if (ipc && *ipc) {
    IPAddress ip, gw, sub(255, 255, 255, 0), dns;
    if (ip.fromString(ipc) && gw.fromString(gwc)) {
      const char* dc = cfgDns.length() ? cfgDns.c_str() : WIFI_DNS;
      if (!dc || !*dc || !dns.fromString(dc)) dns = IPAddress(1, 1, 1, 1);
      WiFi.config(ip, gw, sub, dns);
      Serial.printf("WiFi: static IP %s gw %s\n", ipc, gwc);
    }
  }
  WiFi.begin(ssid, pass);
  uint32_t t0 = millis();
  while (WiFi.status() != WL_CONNECTED && millis() - t0 < 30000) {
    delay(250);
    Serial.print(".");
  }
  Serial.println();
  return WiFi.status() == WL_CONNECTED;
}

// ESP-Touch / SmartConfig provisioning: the phone app pushes SSID+password over the
// air, so no SoftAP and no portal are needed. The radio runs in STA+promiscuous only
// during this call, so steady-state cost is zero. Same API on ESP8266 and ESP32.
static void serialPump(); // defined with the serial handlers below (keeps serial alive here)

static bool trySmartConfig(uint32_t timeoutMs) {
  WiFi.mode(WIFI_STA);
#if defined(ESP8266)
  WiFi.setSleepMode(WIFI_NONE_SLEEP);
#else
  WiFi.setSleep(false);
#endif
  WiFi.beginSmartConfig();
  Serial.printf("[smartconfig] waiting %lus for the ESP-Touch app...\n", (unsigned long)(timeoutMs / 1000));
  uint32_t t0 = millis();
  while (!WiFi.smartConfigDone() && millis() - t0 < timeoutMs) {
    delay(200);
    Serial.print(".");
    serialPump();
  }
  Serial.println();
  if (!WiFi.smartConfigDone()) {
    WiFi.stopSmartConfig();
    Serial.println("[smartconfig] timeout");
    return false;
  }
  Serial.println("[smartconfig] credentials received, connecting...");
  uint32_t t1 = millis();
  while (WiFi.status() != WL_CONNECTED && millis() - t1 < 20000) {
    delay(200);
    Serial.print(".");
    serialPump();
  }
  Serial.println();
  if (WiFi.status() != WL_CONNECTED) {
    Serial.println("[smartconfig] not connected");
    return false;
  }
  String ss = WiFi.SSID(), pw = WiFi.psk();
  prefs.begin("wifi", false);
  prefs.putString("ssid", ss);
  prefs.putString("pass", pw);
  prefs.end();
  Serial.printf("[smartconfig] saved \"%s\"\n", ss.c_str());
  return true;
}

// ---------- serial provisioning: Improv Wi-Fi (standard) + plain-text CFG ----------
// The browser installer speaks Improv Wi-Fi Serial (https://www.improv-wifi.com/serial/),
// the same protocol used by ESP Web Tools / Tasmota / ESPHome — it supports Wi-Fi scans
// and device info. The plain-text CFG lines are kept as a minimal scripting fallback.
//   CFG ssid <name> / pass / host / ip / gw / dns … then  CFG commit
// Both paths write /wifi.cfg, preserving unrelated keys.

enum ImprovPacket { IMPROV_STATE = 0x01,
                    IMPROV_ERROR = 0x02,
                    IMPROV_RPC = 0x03,
                    IMPROV_RESULT = 0x04 };
enum ImprovCmd {
  IMPROV_CMD_WIFI = 0x01,
  IMPROV_CMD_STATE = 0x02,
  IMPROV_CMD_INFO = 0x03,
  IMPROV_CMD_SCAN = 0x04,
  IMPROV_CMD_HOST = 0x05,
};
enum ImprovStatus { IMPROV_S_READY = 0x02,
                    IMPROV_S_PROVISIONING = 0x03,
                    IMPROV_S_PROVISIONED = 0x04 };
enum ImprovError {
  IMPROV_E_NONE = 0x00,
  IMPROV_E_INVALID = 0x01,
  IMPROV_E_UNKNOWN_CMD = 0x02,
  IMPROV_E_CONNECT = 0x03,
  IMPROV_E_HOSTNAME = 0x05,
};

static uint8_t improvCs;
static void improvStart(uint8_t type, uint8_t len) {
  improvCs = 0;
  const char* m = "IMPROV";
  for (uint8_t i = 0; i < 6; i++) {
    Serial.write((uint8_t)m[i]);
    improvCs += (uint8_t)m[i];
  }
  Serial.write((uint8_t)1);
  improvCs += 1;
  Serial.write(type);
  improvCs += type;
  Serial.write(len);
  improvCs += len;
}
static void improvPut(uint8_t b) {
  Serial.write(b);
  improvCs += b;
}
static void improvPutStr(const char* s) {
  size_t n = strlen(s);
  improvPut((uint8_t)n);
  for (size_t i = 0; i < n; i++) improvPut((uint8_t)s[i]);
}
static void improvFinish() {
  Serial.write(improvCs);
  Serial.write((uint8_t)'\n');
}
static void improvSetState(uint8_t st) {
  improvStart(IMPROV_STATE, 1);
  improvPut(st);
  improvFinish();
}
static void improvError(uint8_t er) {
  improvStart(IMPROV_ERROR, 1);
  improvPut(er);
  improvFinish();
}
static void improvResult(uint8_t rpc, const char* const* strs, uint8_t n) {
  uint8_t total = 0;
  for (uint8_t i = 0; i < n; i++) total += (uint8_t)(1 + strlen(strs[i]));
  improvStart(IMPROV_RESULT, (uint8_t)(2 + total));
  improvPut(rpc);
  improvPut(total);
  for (uint8_t i = 0; i < n; i++) improvPutStr(strs[i]);
  improvFinish();
}

// Merge the credentials into /wifi.cfg; only the provided keys are replaced.
static bool wifiCfgWrite(const String& ssid, const String& pass, const String& host,
                         const String& ip = "", const String& gw = "", const String& dns = "") {
  String keep;
  File rf = LittleFS.open("/wifi.cfg", "r");
  if (rf) {
    while (rf.available()) {
      String old = rf.readStringUntil('\n');
      old.trim();
      if (!old.length()) continue;
      if (old.startsWith("#")) {
        keep += old + "\n";
        continue;
      } // keep comments
      int eq = old.indexOf('=');
      String k = eq > 0 ? old.substring(0, eq) : String("");
      k.trim();
      k.toUpperCase();
      if (k == "WIFI_SSID" || k == "WIFI_PASS" || k == "WIFI_HOST" ||
          k == "WIFI_IP" || k == "WIFI_GW" || k == "WIFI_DNS") continue;
      keep += old + "\n";
    }
    rf.close();
  }
  File wf = LittleFS.open("/wifi.cfg", "w");
  if (!wf) return false;
  wf.print(keep);
  if (ssid.length()) wf.printf("WIFI_SSID=%s\nWIFI_PASS=%s\n", ssid.c_str(), pass.c_str());
  if (host.length()) wf.printf("WIFI_HOST=%s\n", host.c_str());
  if (ip.length()) wf.printf("WIFI_IP=%s\n", ip.c_str());
  if (gw.length()) wf.printf("WIFI_GW=%s\n", gw.c_str());
  if (dns.length()) wf.printf("WIFI_DNS=%s\n", dns.c_str());
  wf.close();
  return true;
}

static bool serialCfgApplied = false; // set once a config was accepted (window ends)

// Persist credentials, then try to connect. Reports state to Improv clients.
static bool applyWifi(const String& ssid, const String& pass, const String& host,
                      const String& ip, const String& gw, const String& dns) {
  if (!ssid.length()) return false;
  if (!wifiCfgWrite(ssid, pass, host, ip, gw, dns)) return false;
  improvSetState(IMPROV_S_PROVISIONING);
  bool ok = connectWiFi();
  improvSetState(ok ? IMPROV_S_PROVISIONED : IMPROV_S_READY);
  if (!ok) improvError(IMPROV_E_CONNECT);
  serialCfgApplied = true;
  return ok;
}

// Try credentials WITHOUT persisting (so a typo can't lock us out of the device).
static bool tryCreds(const String& ssid, const String& pass, uint32_t timeoutMs) {
  WiFi.mode(WIFI_STA);
  WiFi.begin(ssid.c_str(), pass.c_str());
  uint32_t t0 = millis();
  while (WiFi.status() != WL_CONNECTED && millis() - t0 < timeoutMs) delay(150);
  return WiFi.status() == WL_CONNECTED;
}
static void currentCreds(String& ssid, String& pass) {
  if (!loadCfgFile(ssid, pass)) {
    prefs.begin("wifi", true);
    ssid = prefs.getString("ssid", "");
    pass = prefs.getString("pass", "");
    prefs.end();
  }
}
// Change network: verify first; persist only on success, otherwise restore the previous one.
static void handleSetWifi() {
  if (!requireAuth()) return;
  String ssid = web.arg("ssid");
  ssid.trim();
  String pass = web.arg("pass");
  web.sendHeader("Cache-Control", "no-store");
  if (!ssid.length()) {
    web.send(400, "text/plain", "SSID required");
    return;
  }
  String oldS, oldP;
  currentCreds(oldS, oldP); // also fills cfgHost/cfgIp/cfgGw/cfgDns
  String keepHost = cfgHost, keepIp = cfgIp, keepGw = cfgGw, keepDns = cfgDns;
  if (tryCreds(ssid, pass, 15000)) {
    wifiCfgWrite(ssid, pass, keepHost, keepIp, keepGw, keepDns);
    web.send(200, "text/plain", "Joined \"" + ssid + "\" (" + WiFi.localIP().toString() + ")");
  } else {
    if (oldS.length()) tryCreds(oldS, oldP, 15000); // roll back
    web.send(200, "text/plain", "Could not join \"" + ssid + "\". Kept the previous network.");
  }
}

// Blocking scan, single request (the UI fetches once, no polling).
static void handleScan() {
  if (!requireAuth()) return;
  web.sendHeader("Cache-Control", "no-store");
  int n = WiFi.scanNetworks();
  String j = "[";
  for (int i = 0; i < n; i++) {
    String ss = WiFi.SSID(i);
    if (!ss.length()) continue;
    j += (j.length() > 1 ? "," : "");
    j += "{\"s\":\"" + jesc(ss) + "\",\"r\":" + WiFi.RSSI(i) + ",\"e\":" + ((int)WiFi.encryptionType(i) != 0 ? 1 : 0) + "}";
  }
  j += "]";
  WiFi.scanDelete();
  web.send(200, "application/json", j);
}

static String currentHostname() {
  File f = LittleFS.open("/wifi.cfg", "r");
  String hn;
  if (f) {
    while (f.available()) {
      String l = f.readStringUntil('\n');
      l.trim();
      if (l.startsWith("WIFI_HOST=")) hn = l.substring(10);
    }
    f.close();
  }
  hn.trim();
  return hn.length() ? hn : String(WIFI_HOST);
}

static bool netIsOpen(uint8_t i) {
#if defined(ESP8266)
  return WiFi.encryptionType(i) == ENC_TYPE_NONE; // 7 on ESP8266
#else
  return WiFi.encryptionType(i) == WIFI_AUTH_OPEN; // 0 on ESP32 family
#endif
}

// NUL-terminated String from a length-prefixed field (SSID/password/hostname).
static String strSlice(const uint8_t* p, uint8_t n) {
  char b[128];
  if (n > sizeof(b) - 1) n = sizeof(b) - 1;
  memcpy(b, p, n);
  b[n] = 0;
  return String(b);
}

static void improvHandleRPC(const uint8_t* data, uint8_t len) {
  if (len < 2 || data[1] > len - 2) {
    improvError(IMPROV_E_INVALID);
    return;
  } // malformed RPC
  uint8_t cmd = data[0];
  const uint8_t* d = data + 2;
  uint8_t dlen = data[1];
  switch (cmd) {
  case IMPROV_CMD_STATE: { // request current state
    bool up = WiFi.status() == WL_CONNECTED;
    improvSetState(up ? IMPROV_S_PROVISIONED : IMPROV_S_READY);
    if (up) {
      String url = "http://" + WiFi.localIP().toString() + "/";
      const char* r[1] = {url.c_str()};
      improvResult(IMPROV_CMD_STATE, r, 1);
    }
    break;
  }
  case IMPROV_CMD_INFO: { // request device info
    String host = currentHostname();
    const char* info[4] = {"esp-adblock", FW_VERSION, ARDUINO_BOARD, host.c_str()};
    improvResult(IMPROV_CMD_INFO, info, 4);
    break;
  }
  case IMPROV_CMD_SCAN: { // scan Wi-Fi networks
    int n = WiFi.scanNetworks();
    if (n < 0) {
      delay(300);
      n = WiFi.scanNetworks();
    } // WIFI_SCAN_RUNNING -> retry
    for (int i = 0; i < n && i < 24; i++) {
      String ssid = WiFi.SSID(i);
      if (!ssid.length()) continue;
      String rssi = String(WiFi.RSSI(i));
      const char* r[3] = {ssid.c_str(), rssi.c_str(), netIsOpen(i) ? "NO" : "YES"};
      improvResult(IMPROV_CMD_SCAN, r, 3);
    }
    improvResult(IMPROV_CMD_SCAN, nullptr, 0); // empty list = end of scan
    break;
  }
  case IMPROV_CMD_HOST: { // get/set hostname
    if (dlen) {
      String h = strSlice(d, dlen);
      h.trim();
      if (!h.length() || !wifiCfgWrite("", "", h)) {
        improvError(IMPROV_E_HOSTNAME);
        break;
      }
    }
    String host = currentHostname();
    const char* r[1] = {host.c_str()};
    improvResult(IMPROV_CMD_HOST, r, 1);
    break;
  }
  case IMPROV_CMD_WIFI: { // send Wi-Fi settings
    if (dlen < 2) {
      improvError(IMPROV_E_INVALID);
      break;
    }
    uint8_t sl = d[0];
    if ((uint16_t)sl + 2 > dlen) {
      improvError(IMPROV_E_INVALID);
      break;
    }
    String ssid = strSlice(d + 1, sl);
    uint8_t pl = d[1 + sl];
    if ((uint16_t)sl + pl + 2 > dlen) {
      improvError(IMPROV_E_INVALID);
      break;
    }
    String pass = strSlice(d + 2 + sl, pl);
    if (!ssid.length()) {
      improvError(IMPROV_E_INVALID);
      break;
    }
    improvError(IMPROV_E_NONE);
    if (applyWifi(ssid, pass, "", "", "", "")) {
      String url = "http://" + WiFi.localIP().toString() + "/";
      const char* r[1] = {url.c_str()};
      improvResult(IMPROV_CMD_WIFI, r, 1);
    }
    break;
  }
  default:
    improvError(IMPROV_E_UNKNOWN_CMD); // unknown RPC command
  }
}

// Byte pump over the console, shared by both protocols. Improv packets are framed
// ("IMPROV" + version + type + len + data + checksum); anything else is a text line.
static uint8_t sBuf[300];
static uint16_t sLen = 0, sNeed = 0;
static bool sImprov = false;
struct PendCfg {
  String ssid, pass, host, ip, gw, dns;
} pend;

static void handleCfgLine(char* l) {
  if (strncmp(l, "CFG", 3) != 0) return;
  if (strcmp(l, "CFG commit") == 0) {
    if (!pend.ssid.length()) {
      Serial.println("CFGERR missing ssid");
      return;
    }
    bool ok = applyWifi(pend.ssid, pend.pass, pend.host, pend.ip, pend.gw, pend.dns);
    Serial.println(ok ? "CFGSAVED" : "CFGERR connect");
    return;
  }
  char* sp = strchr(l, ' ');
  if (!sp) return;
  *sp = 0;
  char* key = l + 4; // "CFG " is 4 chars
  char* val = sp + 1;
  if (!strcmp(key, "ssid")) pend.ssid = val;
  else if (!strcmp(key, "pass")) pend.pass = val;
  else if (!strcmp(key, "host")) pend.host = val;
  else if (!strcmp(key, "ip")) pend.ip = val;
  else if (!strcmp(key, "gw")) pend.gw = val;
  else if (!strcmp(key, "dns")) pend.dns = val;
}

static void serialFeedByte(uint8_t b) {
  if (!sImprov) {
    if (b == '\n') {
      sBuf[sLen] = 0;
      if (sLen) handleCfgLine((char*)sBuf);
      sLen = 0;
      return;
    }
    if (sLen < sizeof(sBuf) - 1) sBuf[sLen++] = b;
    else sLen = 0;
    if (sLen == 9 && memcmp(sBuf, "IMPROV", 6) == 0) {
      sImprov = true;
      sNeed = 9 + sBuf[8] + 1;
    }
    return;
  }
  if (sLen < sizeof(sBuf) - 1) sBuf[sLen++] = b;
  if (sLen >= sNeed) {
    uint8_t cs = 0;
    for (uint16_t i = 0; i + 1 < sNeed; i++) cs += sBuf[i];
    if (sBuf[6] == 1 && cs == sBuf[sNeed - 1] && sBuf[7] == IMPROV_RPC)
      improvHandleRPC(sBuf + 9, sBuf[8]);
    else
      improvError(IMPROV_E_INVALID);
    sLen = 0;
    sImprov = false;
    sNeed = 0;
  }
}

static void serialPump() {
  while (Serial.available()) serialFeedByte((uint8_t)Serial.read());
}

static bool serialProvision(uint32_t windowMs) {
  pend = PendCfg();
  Serial.printf("[provision] serial window %lus (Improv Wi-Fi + CFG lines)\n", (unsigned long)(windowMs / 1000));
  Serial.println("CFGREADY");
  improvSetState(WiFi.status() == WL_CONNECTED ? IMPROV_S_PROVISIONED : IMPROV_S_READY);
  uint32_t t0 = millis();
  while (!serialCfgApplied && millis() - t0 < windowMs) {
    if (!Serial.available()) {
      delay(5);
      continue;
    }
    serialPump();
  }
  if (!serialCfgApplied) Serial.println("CFGTIMEOUT");
  return serialCfgApplied;
}

// Runtime WiFi watchdog: if the link drops, reconnect with a growing backoff capped at 30 s.
static void wifiWatchdog() {
  if (WiFi.status() == WL_CONNECTED) {
    wifiDownSince = 0;
    lastReconn = 0;
    reconnAttempts = 0;
    return;
  }
  uint32_t now = millis();
  if (!wifiDownSince) {
    wifiDownSince = now;
    lastReconn = now;
    return;
  }
  uint32_t backoff = (reconnAttempts > 5) ? 30 : (1u << reconnAttempts); // 1,2,4,8,16,30(cap)
  if (backoff > 30) backoff = 30;
  if ((uint32_t)(now - lastReconn) >= backoff * 1000UL) {
    lastReconn = now;
    if (reconnAttempts < 15) reconnAttempts++;
    Serial.printf("[wifi] down %lus — reconnect (backoff %lus)\n",
                  (unsigned long)((now - wifiDownSince) / 1000), (unsigned long)backoff);
    WiFi.reconnect();
  }
}

void setup() {
  Serial.begin(115200);
  delay(300);
  pinMode(LED_PIN, OUTPUT);
  digitalWrite(LED_PIN, LED_ON); // LED on while booting/initializing
  Serial.println("\n[esp-adblock] booting");
#if defined(ESP8266)
  if (!LittleFS.begin()) {
    LittleFS.format();
    LittleFS.begin();
  }
#else
  if (!LittleFS.begin(true)) Serial.println("LittleFS FAILED");
#endif
  reopenBlocklist();
  Serial.printf("blocklist: %u domains\n", (unsigned)numHashes);
  loadRules();
  loadHosts();
  loadNames();
  loadBlockCfg();
  loadProxyCfg();
  loadStats();
  loadDnsCfg();
  {
    File f = LittleFS.open("/boot.cnt", "r");
    if (f) {
      bootId = f.readStringUntil('\n').toInt();
      f.close();
    }
    bootId = bootDbgInit(bootId + 1); // no-op unless BOOT_DEBUG; may adopt a recorded id
    f = LittleFS.open("/boot.cnt", "w");
    if (f) {
      f.println(bootId);
      f.close();
    }
  }
  Serial.printf("rules: block=%d allow=%d keyword=%d\n", numBlock, numAllow, numKw);

  // Hold BOOT at power-on to wipe saved WiFi and force re-provisioning (SmartConfig).
#if defined(ESP8266)
  const int BOOT_PIN = 0; // ESP8266 BOOT / GPIO0
#elif CONFIG_IDF_TARGET_ESP32C3
  const int BOOT_PIN = 9; // C3 BOOT button
#else
  const int BOOT_PIN = 0; // classic ESP32 BOOT button (GPIO9 is a flash pin there)
#endif
  pinMode(BOOT_PIN, INPUT_PULLUP);
  if (digitalRead(BOOT_PIN) == LOW) {
    delay(60);
    if (digitalRead(BOOT_PIN) == LOW) {
      prefs.begin("wifi", false);
      prefs.clear();
      prefs.end();
      Serial.println("[setup] BOOT held -> cleared saved WiFi");
    }
  }

  if (!connectWiFi()) {
    if (!hasCreds()) {
      // No credentials: accept the browser installer's serial config, or ESP-Touch.
      // Short windows so whichever source arrives first is handled promptly.
      serialCfgApplied = false;
      for (;;) {
        if (serialProvision(10000)) {
          Serial.println("[provision] /wifi.cfg written");
          break;
        }
        if (trySmartConfig(10000)) break;
        if (WiFi.status() == WL_CONNECTED) break; // config arrived while ESP-Touch was listening
        Serial.println("[provision] retry — serial CFG lines or the ESP-Touch app");
      }
      if (!connectWiFi()) {
        Serial.println("[provision] still not connected; rebooting in 10s");
        bootDbgMarkRestart(BOOT_INTENT_PROVISION);
        delay(10000);
        ESP.restart();
      }
      Serial.printf("WiFi up: %s\n", WiFi.localIP().toString().c_str());
    } else {
      // Creds exist but the link is down (router off?): reboot and retry.
      Serial.println("[setup] saved WiFi didn't connect; rebooting in 30s");
      bootDbgMarkRestart(BOOT_INTENT_PROVISION);
      delay(30000);
      ESP.restart();
    }
  }
  Serial.printf("WiFi up: %s\n", WiFi.localIP().toString().c_str());
  if (MDNS.begin("esp-adblock")) {
    MDNS.addService("http", "tcp", 80);
    Serial.println("dashboard: http://esp-adblock.local");
  }

  if (strcmp(WEB_PASS, "change-me-please") == 0)
    Serial.println("[WARN] secrets.h still has a placeholder WEB_PASS — set a real value "
                   "(config.env) before trusting this device on a network you don't fully control.");

  dnsServer.begin(DNS_PORT);
  upstreamCli.begin(0);
  probeCli.begin(0);
  tcpDns.begin();
  tcpDns.setNoDelay(true); // TCP :53 fallback for truncated UDP replies
  tcpRelay.begin(tcpDns, upstreamIP, DNS_PORT, tcpBuf, sizeof(tcpBuf), tcpResolve, tcpReplied, nullptr);
  blackhole.begin();       // drop PAC-routed URL matches (see /proxy.pac)
#if defined(ESP8266)
  web.collectHeaders(CSRF_HEADER); // ESP8266 variadic overload; a char*[] picks the wrong template
#else
  {
    const char* hdrs[] = {CSRF_HEADER};
    web.collectHeaders(hdrs, 1);
  } // needed for requireAuth()'s CSRF check
#endif
  web.on("/", handleRoot); // dashboard, or block page for a sinkholed host
  web.on("/stats.json", handleStats);
  web.on("/events", handleEvents);                                    // recent-blocked ring (frontend keeps history)
  web.on("/world.svg", handleWorldSvg);                               // static map for the destination card
  web.on("/__dnscheck", []() { web.send(200, "text/plain", "ok"); }); // resolver-usage probe (see lookupHost)
  web.on("/allow", handleAllow);                                      // block-page "continue" (CSRF-gated, no Basic auth)
  web.on("/setblock", handleSetBlock);                                // blocked-reply mode (ip/zero/nxdomain)
  web.on("/setdns", []() {                                            // upstream candidates (comma/space/newline separated)
    if (!requireAuth()) return;
    String csv = web.arg("d");
    if (!dnsParseList(csv)) {
      web.send(400, "text/plain", "bad list: need 1-4 IPv4 addresses");
      return;
    }
    saveDnsCfg();
    dnsCur = 0;
    dnsNext = 0; // applied when no query is in flight
    dnsRoundStart = 0;
    dnsProbeNext = 0; // probe the new list right away
    web.send(200, "text/plain", "ok");
  });
  web.on("/proxy.pac", HTTP_GET, handlePac); // auto-proxy config (no auth: OS/browser fetch)
  web.on("/wpad.dat", HTTP_GET, handlePac);  // WPAD alias (DNS answers "wpad" -> this device)
  web.on("/dns-query", HTTP_GET, handleDoh); // DoH (RFC 8484) over plain HTTP; no TLS
  web.on("/dns-query", HTTP_POST, handleDoh);
  web.on("/setproxy", handleSetProxy);       // set the PAC proxy (host:port)
  web.on("/sethost", handleSetHost);         // local DNS record add/replace
  web.on("/delhost", handleDelHost);         // local DNS record remove
  web.on("/addblock", []() { if (!requireAuth()) return; String d = web.arg("d"); if (d.indexOf('*') >= 0) addWild(d); else addBlock(d); web.send(200, "text/plain", "ok"); });
  web.on("/unblock", []() { if (!requireAuth()) return; String d = web.arg("d"); removeBlock(d); removeWild(d); web.send(200, "text/plain", "ok"); });
  web.on("/delallow", []() { if (!requireAuth()) return; removeAllow(web.arg("d"));   web.send(200, "text/plain", "ok"); });
  web.on("/addkeyword", []() { if (!requireAuth()) return; addKeyword(web.arg("t"));   web.send(200, "text/plain", "ok"); });
  web.on("/delkeyword", []() { if (!requireAuth()) return; removeKeyword(web.arg("t")); web.send(200, "text/plain", "ok"); });
  // Raw /rules.cfg read + replace (the whole file); loadRules() reparses after a write.
  web.on("/rules", HTTP_GET, []() { if (!requireAuth()) return; File f = LittleFS.open("/rules.cfg", "r"); String s = f ? f.readString() : String(""); if (f) f.close(); web.send(200, "text/plain", s); });
  web.on("/rules", HTTP_POST, []() {
    if (!requireAuth()) return;
    String body = web.arg("plain");
    noteHeap(1); // a pasted rules file doubles in RAM (arg + copy): the one user-driven OOM path
    int cb = 0, ca = 0, ck = 0, cw = 0, cu = 0; // count per kind before writing
    for (int start = 0; start <= (int)body.length();) {
      int nl = body.indexOf('\n', start);
      if (nl < 0) nl = body.length();
      String l = body.substring(start, nl);
      l.trim();
      start = nl + 1;
      if (!l.length() || l[0] == '#') continue;
      if (l.startsWith("@@||")) {
        ca++;
        continue;
      }
      bool wild = l.indexOf('*') >= 0;
      if (l.startsWith("||")) {
        if (wild) cw++;
        else cb++;
        continue;
      }
      int sp = l.indexOf(' ');
      String verb = (sp < 0) ? l : l.substring(0, sp);
      verb.toLowerCase();
      if (verb == "block" || verb == "b") {
        if (wild) cw++;
        else cb++;
      } else if (verb == "allow" || verb == "a") ca++;
      else if (verb == "keyword" || verb == "k") ck++;
      else if (verb == "wildcard" || verb == "w") cw++;
      else if (verb == "url" || verb == "u") cu++;
    }
    if (cb > MAX_CUSTOM || ca > MAX_ALLOW || ck > MAX_KW || cw > MAX_WILD || cu > MAX_URL) {
      web.send(400, "text/plain", String("too many rules (max block=") + MAX_CUSTOM + " allow=" + MAX_ALLOW + " keyword=" + MAX_KW + " wildcard=" + MAX_WILD + " url=" + MAX_URL + "); not saved");
      return;
    }
    File f = LittleFS.open("/rules.cfg", "w");
    if (f) {
      f.print(body);
      f.close();
    }
    loadRules();
    web.send(200, "text/plain", "ok");
  });
  web.on("/pause", []() { // /pause?s=300  (0 or absent = indefinite)
    if (!requireAuth()) return;
    long s = web.hasArg("s") ? web.arg("s").toInt() : 0;
    blockingOn = false;
    resumeAt = (s > 0) ? millis() + (uint32_t)s * 1000UL : 0;
    web.send(200, "text/plain", "paused");
  });
  web.on("/resume", []() { if (!requireAuth()) return; blockingOn = true; resumeAt = 0; web.send(200, "text/plain", "resumed"); });
  web.on("/setwifi", handleSetWifi);                                // change network (verify, then persist)
  web.on("/scan", handleScan);                                      // nearby networks for the picker
  web.on("/upload", HTTP_POST, handleUploadDone, handleUpload);     // blocklist OTA (auth inside handleUpload)
  web.on("/update", HTTP_POST, handleFwUpdateDone, handleFwUpload); // firmware OTA (auth inside handleFwUpload)
  web.on("/resetstats", []() { if (!requireAuth()) return; resetStats(); web.send(200, "text/plain", "ok"); });
  web.on("/setname", []() { if (!requireAuth()) return; bool ok = setClientName(web.arg("ip").c_str(), web.arg("n")); web.send(ok ? 200 : 400, "text/plain", ok ? "ok" : "bad ip/name"); });
  web.on("/pauseclient", []() { // per-client pause: /pauseclient?ip=1.2.3.4&s=3600 (s=0 clears)
    if (!requireAuth()) return;
    IPAddress ip;
    if (!ip.fromString(web.arg("ip"))) {
      web.send(400, "text/plain", "bad ip");
      return;
    }
    long s = web.hasArg("s") ? web.arg("s").toInt() : 3600;
    if (s < 0) s = 0;
    if (s > 86400) s = 86400;
    Dev* c = nullptr;
    for (int i = 0; i < numClients; i++)
      if (clients[i].ip == (uint32_t)ip) {
        c = &clients[i];
        break;
      }
    if (!c) {
      web.send(404, "text/plain", "unknown ip");
      return;
    }
    c->pausedUntil = s ? millis() + (uint32_t)s * 1000UL : 0;
    web.send(200, "text/plain", "ok");
  });
  web.onNotFound(handleNotFound); // sinkholed hosts -> block page
  web.begin();
  ArduinoOTA.setHostname("esp-adblock"); // pio run -t upload --upload-port esp-adblock.local
  ArduinoOTA.setPassword(WEB_PASS);      // OTA uses the dashboard credential — no separate OTA password
  ArduinoOTA.begin();
  Serial.println("DNS :53 + dashboard :80 + OTA up");
  digitalWrite(LED_PIN, LED_OFF); // ready: LED now off, and blinks only on a blocked lookup
}

void loop() {
  uint32_t _l = micros();
  static uint32_t _prev = 0;
  if (_prev && _l - _prev > stMaxGap) stMaxGap = _l - _prev;
  _prev = _l;
  ArduinoOTA.handle();
  wifiWatchdog();
#if !defined(ESP8266)
  confirmOtaIfSettled();
#endif
  uint32_t _d0 = micros();
  bool busy = handleDns(); // DNS first (latency-sensitive)
  uint32_t _dd = micros() - _d0;
  if (_dd > stMaxDns) stMaxDns = _dd;
  pollUpstream();                                      // relay any upstream replies for in-flight queries
  noteHeap(2);                                         // low-water mark attributed to the DNS path
  probeDnsTick();                                      // non-blocking latency sweep (own UDP socket)
  applyDnsSwitch();                                    // only when nothing is in flight
  uint32_t _t0 = micros();
  tcpRelay.poll(); // TCP :53 fallback (one incremental step; the connect is the only bounded stall)
  uint32_t _td = micros() - _t0;
  if (_td > stMaxTcp) stMaxTcp = _td;
  handleBlackhole();                                   // drop PAC-routed URL matches
  if (!busy || (uint32_t)(millis() - lastWeb) > 100) { // web only when idle (anti-starvation cap)
    lastWeb = millis();
    uint32_t _w0 = micros();
    web.handleClient();
    uint32_t _ww = micros() - _w0;
    if (_ww > stMaxWeb) stMaxWeb = _ww;
    noteHeap(1); // low-water mark attributed to a web request (bursts of these are the OOM risk)
  }
#if defined(ESP8266)
  MDNS.update();
#endif
  if (!blockingOn && resumeAt && (int32_t)(millis() - resumeAt) >= 0) {
    blockingOn = true;
    resumeAt = 0;
  }
  bootDbgTick(WiFi.status() == WL_CONNECTED); // no-op unless BOOT_DEBUG (SNTP + /boot.cfg)
  cpu_gov::checkIdle();              // CPU governor: ondemand (self-throttled)
  // Deferred flash write: never from a handler, never with a query/TCP job in flight (a
  // write disables the flash cache and would land inside the DNS path). The 30 s fallback
  // keeps a permanently busy resolver from deferring the counters forever.
  static uint32_t statsPendingAt = 0;
  static bool statsPending = false;
  if (statsSaveReq.pending() && !statsPending) {
    statsPending = true;
    statsPendingAt = millis();
  }
  bool flashIdle = !busy && !tcpRelay.active() && dnsIdle();
  bool flashStale = statsPending && (uint32_t)(millis() - statsPendingAt) >= 30000UL;
  if (statsPending && (flashIdle || flashStale)) {
    statsSaveReq.take();
    statsPending = false;
    saveStats();
  }
  static uint32_t lastStatsSave = 0; // mark for persistence every ~5 min (only if changed)
  if ((uint32_t)(millis() - lastStatsSave) >= 300000UL) {
    lastStatsSave = millis();
    uint32_t gsum = gafamCnt[0] + gafamCnt[1] + gafamCnt[2] + gafamCnt[3] + gafamCnt[4] + gafamCnt[5];
    if (totalBlocked != savedBlocked || totalAllowed != savedAllowed || totalCached != savedCached ||
        gsum != savedGafam || dnssecSeen != savedDnssec || secPages != savedSecPages ||
        pagesServed != savedPagesServed)
      statsSaveReq.mark();
  }
  if (ledUntil && (int32_t)(millis() - ledUntil) >= 0) {
    digitalWrite(LED_PIN, LED_OFF);
    ledUntil = 0;
  }                    // status LED off
  if (!busy) delay(1); // sleep only when idle: full speed under load, cool when quiet
}
